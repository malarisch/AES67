/*
 * Example device-tree overlay binding the AES67 FPGA to an SPI controller on
 * the host SoC. Adjust the SPI bus phandle, chip-select, clock rate, and the
 * RX-ready interrupt GPIO to match your board's wiring.
 *
 * Build:  dtc -@ -I dts -O dtb -o aes67-overlay.dtbo aes67-overlay.dts
 *
 * Two drivers: the spibone bus driver (driver/spibone) owns the SPI device
 * (compatible "litex,spibone") and creates the AES67 core as a client device
 * from the child node (compatible "aes67,eth", reg = Wishbone window), which
 * the aes67_eth driver binds. If `interrupts` is present on the child
 * (eth_buf_irq wired to a GPIO), RX is interrupt-driven; otherwise the driver
 * falls back to polling (module param poll_ms).
 *
 * litex,online-at-probe: the FPGA configures itself from flash, so the bridge
 * is there at boot. Without it the bus starts offline and is set online from
 * userspace after the FPGA has been configured (/sys/bus/spi/devices/<dev>/state).
 *
 * Raspberry Pi note: with `dtparam=spi=on` the firmware already attaches the
 * userspace `spidev` driver to CS0 (spi0.0), which then OWNS the chip-select —
 * adding our device at the same CS fails with "chipselect 0 already in use"
 * (-EBUSY). The first fragment disables that spidev node so our driver can claim
 * CS0. Keep SPI itself enabled (the controller must stay on). On other boards
 * that do not pre-bind spidev, the &spidev0 fragment is simply ignored.
 */
/dts-v1/;
/plugin/;

/* Release CS0 from the default spidev binding (Raspberry Pi). */
&spidev0 {
	status = "disabled";
};

&spi0 {
	status = "okay";
	#address-cells = <1>;
	#size-cells = <0>;

	fpga@0 {
		compatible = "litex,spibone";
		reg = <0>;                       /* chip-select 0 */
		spi-max-frequency = <8000000>;   /* spibone samples SCLK with its sys_clk: keep at or below sys_clk / 12 */
		/* SPI mode 0 (CPOL=0, CPHA=0): drive NEITHER spi-cpol NOR spi-cpha. */
		litex,online-at-probe;
		#address-cells = <1>;
		#size-cells = <1>;

		aes67@90000000 {
			compatible = "aes67,eth";
			reg = <0x90000000 0x20000>;  /* AES67 window of the aes67_bridge csr.csv */

			/* RX-ready IRQ from eth_buf_irq. Example: GPIO25 on a Pi-style
			 * gpio controller, rising edge. Remove both lines to poll. */
			interrupt-parent = <&gpio>;
			interrupts = <25 1>;         /* 1 = IRQ_TYPE_EDGE_RISING */
		};
	};
};
