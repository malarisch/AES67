## soc_firmware/app/drivers/eth_fmc_basic/Kconfig.fmc_basic
```kconfig
menuconfig ETH_FMC_BASIC
	bool "Parallel FMC Ethernet interface"
	select NET_L2_ETHERNET
	help
	  Enables a simple FMC-connected Ethernet MAC bridge. This uses a
	  memory-mapped register window compatible with the existing SPI
	  Ethernet bridge but accessed via the STM32H7 FMC in bank 0.

if ETH_FMC_BASIC

config ETH_FMC_BASE_ADDR
	hex "FMC base address for Ethernet peripheral"
	default 0x60000000
	help
	  Base address of the FMC bank used for the Ethernet bridge.

config ETH_FMC_POLL_INTERVAL_MS
	int "RX poll interval (ms)"
	default 100
	help
	  Polling interval for RX-ready status when no interrupt line is wired.

config ETH_FMC_BASIC_RX_STACK_SIZE
	int "RX/TX thread stack size"
	default 1024
	help
	  Stack size for RX and TX worker threads.

endif # ETH_FMC_BASIC
```

## soc_firmware/app/drivers/eth_spi_basic/Kconfig.spi_basic
```kconfig
# SPDX-License-Identifier: Apache-2.0

menuconfig ETH_SPI_BASIC
    bool "Basic SPI Ethernet Driver"
    default y
    depends on DT_HAS_VENDOR_SPI_ETHERNET_ENABLED
    select SPI
    select GPIO
    help
      Enable driver for basic SPI-based Ethernet controller.

if ETH_SPI_BASIC

config ETH_SPI_BASIC_RX_STACK_SIZE
    int "RX thread stack size"
    default 1024
    help
      Stack size for the RX thread that processes incoming packets.

config ETH_SPI_BASIC_TIMEOUT
    int "Timeout for SPI operations (ms)"
    default 200
    help
      Timeout in milliseconds for SPI read/write operations.

config ETH_SPI_BASIC_INIT_PRIORITY
    int "Driver initialization priority"
    default 80
    help
      Initialization priority for the driver. Should be higher than
      SPI and GPIO initialization priorities.

endif # ETH_SPI_BASIC
```
