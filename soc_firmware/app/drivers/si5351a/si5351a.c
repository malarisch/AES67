/*
 * Copyright (c) 2025
 * SPDX-License-Identifier: Apache-2.0
 *
 * THIS DRIVER WAS FULLY GENERATED BY CLAUDE OPUS 4.6 - USE WITH CAUTION!

 * Si5351A I2C programmable clock generator – Zephyr out-of-tree driver.
 *
 * Implements the recommended start-up sequence from the Si5351 datasheet
 * (Rev 1.2) §5 and register map from AN619.
 *
 * Si5351A variant: 3 outputs (CLK0, CLK1, CLK2), 2 PLLs (A, B).
 * I2C address: 0x60 (7-bit, A-variant default).
 *
 * Signal chain:
 *   XTAL → PLL (feedback multisynth) → VCO (600-900 MHz)
 *        → Multisynth divider (4-900, fractional)
 *        → R divider (/1 .. /128)
 *        → CLKn output
 */

#include <zephyr/kernel.h>
#include <zephyr/device.h>
#include <zephyr/drivers/i2c.h>
#include <zephyr/logging/log.h>
#include <zephyr/sys/util.h>

#include "si5351a.h"

LOG_MODULE_REGISTER(si5351a, CONFIG_LOG_DEFAULT_LEVEL);

/* ===================================================================
 * Si5351 Register Map (from datasheet & AN619)
 * =================================================================== */

/* Status & control */
#define SI5351_REG_DEV_STATUS        0   /* Device Status */
#define SI5351_REG_INT_STATUS        1   /* Interrupt Status Sticky */
#define SI5351_REG_INT_MASK          2   /* Interrupt Status Mask */
#define SI5351_REG_OUTPUT_EN         3   /* Output Enable Control */
#define SI5351_REG_OEB_PIN_EN        9   /* OEB Pin Enable Control */
#define SI5351_REG_PLL_INPUT_SRC    15   /* PLL Input Source */

/* Per-output CLK control (regs 16..23 for CLK0..CLK7) */
#define SI5351_REG_CLK0_CTRL        16
#define SI5351_REG_CLK1_CTRL        17
#define SI5351_REG_CLK2_CTRL        18

/* Disable state */
#define SI5351_REG_CLK3_0_DIS_STATE 24
#define SI5351_REG_CLK7_4_DIS_STATE 25

/* PLL feedback multisynth parameters (8 regs each) */
#define SI5351_REG_MSNA_BASE        26   /* Regs 26..33 – PLLA */
#define SI5351_REG_MSNB_BASE        34   /* Regs 34..41 – PLLB */

/* Output multisynth parameters (8 regs each, MS0-MS5) */
#define SI5351_REG_MS0_BASE         42   /* Regs 42..49 */
#define SI5351_REG_MS1_BASE         50   /* Regs 50..57 */
#define SI5351_REG_MS2_BASE         58   /* Regs 58..65 */

/* Phase offset */
#define SI5351_REG_CLK0_PHOFF      165
#define SI5351_REG_CLK1_PHOFF      166
#define SI5351_REG_CLK2_PHOFF      167

/* PLL Reset */
#define SI5351_REG_PLL_RST         177

/* Crystal load capacitance */
#define SI5351_REG_XTAL_CL         183

/* Fanout enable */
#define SI5351_REG_FANOUT_EN       187

/* ---- Bit definitions ---- */

/* Device Status (reg 0) */
#define SI5351_STATUS_SYS_INIT     BIT(7)
#define SI5351_STATUS_LOL_B        BIT(6)
#define SI5351_STATUS_LOL_A        BIT(5)
#define SI5351_STATUS_LOS_CLKIN    BIT(4)
#define SI5351_STATUS_LOS_XTAL     BIT(3)

/* CLKn Control (regs 16-23) */
#define SI5351_CLK_PDN             BIT(7)   /* Power-down */
#define SI5351_CLK_MS_INT          BIT(6)   /* Integer mode */
#define SI5351_CLK_MS_SRC_B        BIT(5)   /* 0=PLLA, 1=PLLB */
#define SI5351_CLK_INV             BIT(4)   /* Invert output */
#define SI5351_CLK_SRC_SHIFT       2
#define SI5351_CLK_SRC_MASK        (0x03 << SI5351_CLK_SRC_SHIFT)
#define SI5351_CLK_SRC_XTAL        (0x00 << SI5351_CLK_SRC_SHIFT)
#define SI5351_CLK_SRC_CLKIN       (0x01 << SI5351_CLK_SRC_SHIFT)
#define SI5351_CLK_SRC_MS          (0x03 << SI5351_CLK_SRC_SHIFT)
#define SI5351_CLK_IDRV_MASK       0x03
#define SI5351_CLK_IDRV_2MA        0x00
#define SI5351_CLK_IDRV_4MA        0x01
#define SI5351_CLK_IDRV_6MA        0x02
#define SI5351_CLK_IDRV_8MA        0x03

/* PLL Reset (reg 177) */
#define SI5351_PLL_RST_B           BIT(7)
#define SI5351_PLL_RST_A           BIT(5)

/* Crystal load capacitance (reg 183) – bits [7:6] */
#define SI5351_XTAL_CL_MASK        0xC0
#define SI5351_XTAL_CL_6PF         (1 << 6)
#define SI5351_XTAL_CL_8PF         (2 << 6)
#define SI5351_XTAL_CL_10PF        (3 << 6)

/* Fanout Enable (reg 187) */
#define SI5351_FANOUT_CLKIN_EN     BIT(7)
#define SI5351_FANOUT_XO_EN        BIT(6)
#define SI5351_FANOUT_MS_EN        BIT(4)

/* Multisynth register offset 2: R-divider & DIV-BY-4 bits (output MS only) */
#define SI5351_MS_R_DIV_SHIFT      4   /* bits [6:4] in the raw register */
#define SI5351_MS_DIVBY4_MASK      0x0C

/* ---- VCO limits ---- */
#define SI5351_VCO_MIN   600000000ULL
#define SI5351_VCO_MAX   900000000ULL

/* ---- PLL feedback multiplier limits ---- */
#define SI5351_PLL_A_MIN   15
#define SI5351_PLL_A_MAX   90

/* ---- Multisynth divider limits (MS0-MS5) ---- */
#define SI5351_MS_DIV_MIN   4
#define SI5351_MS_DIV_MAX   900

/* ---- Max 20-bit parameter value ---- */
#define SI5351_P_MAX  0xFFFFF   /* 1 048 575 */

/* ---- Multisynth parameter block length ---- */
#define SI5351_MS_PARAMS_LEN  8

/* ===================================================================
 * Driver data structures
 * =================================================================== */

#define DT_DRV_COMPAT silabs_si5351a

struct si5351a_config {
	struct i2c_dt_spec i2c;
	uint32_t           xtal_freq;   /* Hz */
	uint8_t            xtal_load;   /* register value for reg 183 */
};

struct si5351a_data {
	uint32_t pll_vco[2];             /* Cached VCO freq per PLL */
	uint8_t  clk_ctrl[SI5351A_OUTPUT_COUNT]; /* Shadow of CLKn ctrl regs */
};

/* ===================================================================
 * I2C helpers
 * =================================================================== */

static int si5351_write_reg(const struct i2c_dt_spec *i2c,
			    uint8_t reg, uint8_t val)
{
	uint8_t buf[2] = { reg, val };

	return i2c_write_dt(i2c, buf, sizeof(buf));
}

static int si5351_read_reg(const struct i2c_dt_spec *i2c,
			   uint8_t reg, uint8_t *val)
{
	return i2c_write_read_dt(i2c, &reg, 1, val, 1);
}

static int si5351_write_bulk(const struct i2c_dt_spec *i2c,
			     uint8_t reg, const uint8_t *data, size_t len)
{
	/* Build a single transaction: [reg, data...] */
	uint8_t buf[SI5351_MS_PARAMS_LEN + 1];

	if (len > SI5351_MS_PARAMS_LEN) {
		return -EINVAL;
	}

	buf[0] = reg;
	memcpy(&buf[1], data, len);

	return i2c_write_dt(i2c, buf, len + 1);
}

/* ===================================================================
 * GCD helper for fraction reduction
 * =================================================================== */

static uint32_t gcd32(uint32_t a, uint32_t b)
{
	while (b) {
		uint32_t t = b;

		b = a % b;
		a = t;
	}
	return a;
}

/* ===================================================================
 * Multisynth P1/P2/P3 calculation (AN619)
 *
 * Divider = a + b/c
 *   P1 = 128*a + floor(128*b/c) - 512
 *   P2 = 128*b - c * floor(128*b/c)
 *   P3 = c
 * =================================================================== */

static void calc_params(uint32_t a, uint32_t b, uint32_t c,
			uint32_t *p1, uint32_t *p2, uint32_t *p3)
{
	if (b == 0 || c == 0) {
		/* Integer mode */
		*p1 = 128 * a - 512;
		*p2 = 0;
		*p3 = 1;   /* c must be non-zero in register */
	} else {
		uint32_t floor_128b_c = (uint32_t)((uint64_t)128 * b / c);

		*p1 = 128 * a + floor_128b_c - 512;
		*p2 = (uint32_t)((uint64_t)128 * b - (uint64_t)c * floor_128b_c);
		*p3 = c;
	}
}

/* ===================================================================
 * Write 8 multisynth parameter bytes to the device.
 *
 * Register layout (AN619 §3.2):
 *   Base+0 : P3[15:8]
 *   Base+1 : P3[7:0]
 *   Base+2 : [7:4]=extra bits, [3:2]=P1[17:16], [1:0]=reserved
 *   Base+3 : P1[15:8]
 *   Base+4 : P1[7:0]
 *   Base+5 : [7:4]=P3[19:16], [3:0]=P2[19:16]
 *   Base+6 : P2[15:8]
 *   Base+7 : P2[7:0]
 *
 * For output multisynth (MS0-5) Base+2 also carries R-divider
 * in bits [6:4] and DIVBY4 in bits [3:2] (not used here by PLL).
 * =================================================================== */

static int write_ms_params(const struct i2c_dt_spec *i2c,
			   uint8_t base_reg,
			   uint32_t p1, uint32_t p2, uint32_t p3,
			   uint8_t extra_byte2)
{
	uint8_t buf[SI5351_MS_PARAMS_LEN];

	buf[0] = (uint8_t)((p3 >> 8) & 0xFF);
	buf[1] = (uint8_t)(p3 & 0xFF);
	buf[2] = extra_byte2 | (uint8_t)((p1 >> 16) & 0x03);
	buf[3] = (uint8_t)((p1 >> 8) & 0xFF);
	buf[4] = (uint8_t)(p1 & 0xFF);
	buf[5] = (uint8_t)(((p3 >> 12) & 0xF0) | ((p2 >> 16) & 0x0F));
	buf[6] = (uint8_t)((p2 >> 8) & 0xFF);
	buf[7] = (uint8_t)(p2 & 0xFF);

	return si5351_write_bulk(i2c, base_reg, buf, SI5351_MS_PARAMS_LEN);
}

/* ===================================================================
 * Map output index → register bases
 * =================================================================== */

static uint8_t ms_base_reg(uint8_t output)
{
	static const uint8_t bases[] = {
		SI5351_REG_MS0_BASE,
		SI5351_REG_MS1_BASE,
		SI5351_REG_MS2_BASE,
	};

	return (output < ARRAY_SIZE(bases)) ? bases[output] : 0;
}

static uint8_t clk_ctrl_reg(uint8_t output)
{
	return SI5351_REG_CLK0_CTRL + output;
}

/* ===================================================================
 * Public API implementation
 * =================================================================== */

int si5351a_setup_pll(const struct device *dev, enum si5351a_pll pll,
		      uint32_t mult, uint32_t num, uint32_t denom)
{
	const struct si5351a_config *cfg = dev->config;
	struct si5351a_data *data = dev->data;
	uint32_t p1, p2, p3;
	uint8_t base;
	int ret;

	if (mult < SI5351_PLL_A_MIN || mult > SI5351_PLL_A_MAX) {
		LOG_ERR("PLL mult %u out of range [%d..%d]",
			mult, SI5351_PLL_A_MIN, SI5351_PLL_A_MAX);
		return -EINVAL;
	}
	if (denom == 0 || denom > SI5351_P_MAX) {
		LOG_ERR("PLL denom %u invalid", denom);
		return -EINVAL;
	}

	/* Reduce fraction */
	if (num > 0) {
		uint32_t g = gcd32(num, denom);

		num /= g;
		denom /= g;
	}

	/* Ensure c fits in 20 bits */
	while (denom > SI5351_P_MAX) {
		num >>= 1;
		denom >>= 1;
		if (denom == 0) {
			denom = 1;
		}
	}

	calc_params(mult, num, denom, &p1, &p2, &p3);

	base = (pll == SI5351A_PLL_A) ? SI5351_REG_MSNA_BASE
				      : SI5351_REG_MSNB_BASE;

	ret = write_ms_params(&cfg->i2c, base, p1, p2, p3, 0);
	if (ret < 0) {
		LOG_ERR("Failed to write PLL%c params: %d",
			(pll == SI5351A_PLL_A) ? 'A' : 'B', ret);
		return ret;
	}

	/* Cache the VCO frequency */
	data->pll_vco[pll] = (uint32_t)(
		(uint64_t)cfg->xtal_freq * mult +
		(uint64_t)cfg->xtal_freq * num / denom);

	LOG_DBG("PLL%c: mult=%u num=%u denom=%u → VCO=%u Hz",
		(pll == SI5351A_PLL_A) ? 'A' : 'B',
		mult, num, denom, data->pll_vco[pll]);

	return 0;
}

int si5351a_setup_multisynth(const struct device *dev, uint8_t output,
			     enum si5351a_pll pll, uint32_t div,
			     uint32_t num, uint32_t denom, uint8_t r_div)
{
	const struct si5351a_config *cfg = dev->config;
	struct si5351a_data *data = dev->data;
	uint32_t p1, p2, p3;
	uint8_t base, extra, clk_reg, clk_val;
	int ret;

	if (output >= SI5351A_OUTPUT_COUNT) {
		return -EINVAL;
	}
	if (div < SI5351_MS_DIV_MIN || div > SI5351_MS_DIV_MAX) {
		LOG_ERR("MS%u div %u out of range [%d..%d]",
			output, div, SI5351_MS_DIV_MIN, SI5351_MS_DIV_MAX);
		return -EINVAL;
	}
	if (denom == 0 || denom > SI5351_P_MAX) {
		return -EINVAL;
	}
	if (r_div > 7) {
		return -EINVAL;
	}

	/* Reduce fraction */
	if (num > 0) {
		uint32_t g = gcd32(num, denom);

		num /= g;
		denom /= g;
	}

	while (denom > SI5351_P_MAX) {
		num >>= 1;
		denom >>= 1;
		if (denom == 0) {
			denom = 1;
		}
	}

	base = ms_base_reg(output);

	/* Handle divide-by-4 special case */
	if (div == 4 && num == 0) {
		p1 = 0;
		p2 = 0;
		p3 = 1;
		extra = (r_div << SI5351_MS_R_DIV_SHIFT) | 0x0C; /* DIVBY4 = 0b11 */
	} else {
		calc_params(div, num, denom, &p1, &p2, &p3);
		extra = (r_div << SI5351_MS_R_DIV_SHIFT);
	}

	ret = write_ms_params(&cfg->i2c, base, p1, p2, p3, extra);
	if (ret < 0) {
		LOG_ERR("Failed to write MS%u params: %d", output, ret);
		return ret;
	}

	/* Update CLK control register: PLL source + Multisynth source + mode */
	clk_reg = clk_ctrl_reg(output);
	clk_val = SI5351_CLK_SRC_MS | (data->clk_ctrl[output] & SI5351_CLK_IDRV_MASK);

	if (pll == SI5351A_PLL_B) {
		clk_val |= SI5351_CLK_MS_SRC_B;
	}

	/* Set integer mode when fractional part is zero (lower jitter) */
	if (num == 0) {
		clk_val |= SI5351_CLK_MS_INT;
	}

	data->clk_ctrl[output] = clk_val;

	ret = si5351_write_reg(&cfg->i2c, clk_reg, clk_val);
	if (ret < 0) {
		LOG_ERR("Failed to write CLK%u ctrl: %d", output, ret);
	}

	LOG_DBG("MS%u: div=%u num=%u denom=%u r_div=%u pll=%c",
		output, div, num, denom, r_div,
		(pll == SI5351A_PLL_A) ? 'A' : 'B');

	return ret;
}

int si5351a_output_enable(const struct device *dev, uint8_t output,
			  bool enable)
{
	const struct si5351a_config *cfg = dev->config;
	uint8_t val;
	int ret;

	if (output >= SI5351A_OUTPUT_COUNT) {
		return -EINVAL;
	}

	ret = si5351_read_reg(&cfg->i2c, SI5351_REG_OUTPUT_EN, &val);
	if (ret < 0) {
		return ret;
	}

	if (enable) {
		val &= ~BIT(output);   /* 0 = enabled */
	} else {
		val |= BIT(output);    /* 1 = disabled */
	}

	ret = si5351_write_reg(&cfg->i2c, SI5351_REG_OUTPUT_EN, val);
	if (ret < 0) {
		LOG_ERR("Failed to set output enable reg: %d", ret);
	}

	LOG_DBG("CLK%u output %s", output, enable ? "enabled" : "disabled");
	return ret;
}

int si5351a_set_drive_strength(const struct device *dev, uint8_t output,
			       enum si5351a_drive drive)
{
	const struct si5351a_config *cfg = dev->config;
	struct si5351a_data *data = dev->data;
	uint8_t clk_reg, clk_val;
	int ret;

	if (output >= SI5351A_OUTPUT_COUNT) {
		return -EINVAL;
	}

	clk_reg = clk_ctrl_reg(output);
	clk_val = (data->clk_ctrl[output] & ~SI5351_CLK_IDRV_MASK) |
		  ((uint8_t)drive & SI5351_CLK_IDRV_MASK);

	data->clk_ctrl[output] = clk_val;

	ret = si5351_write_reg(&cfg->i2c, clk_reg, clk_val);
	if (ret < 0) {
		LOG_ERR("Failed to set CLK%u drive: %d", output, ret);
	}

	return ret;
}

int si5351a_pll_reset(const struct device *dev, enum si5351a_pll pll)
{
	const struct si5351a_config *cfg = dev->config;
	uint8_t val = 0;

	if (pll == SI5351A_PLL_A) {
		val = SI5351_PLL_RST_A;
	} else {
		val = SI5351_PLL_RST_B;
	}

	LOG_DBG("PLL%c reset", (pll == SI5351A_PLL_A) ? 'A' : 'B');
	return si5351_write_reg(&cfg->i2c, SI5351_REG_PLL_RST, val);
}

/* ===================================================================
 * High-level: set_frequency
 *
 * Strategy:
 *   1. Pick an even integer multisynth divider for lowest jitter.
 *   2. Use a fractional PLL to reach the exact VCO frequency.
 *   3. For frequencies below ~500 kHz use the R output divider.
 * =================================================================== */

int si5351a_set_frequency(const struct device *dev, uint8_t output,
			  uint32_t freq_hz)
{
	const struct si5351a_config *cfg = dev->config;
	uint32_t xtal = cfg->xtal_freq;
	enum si5351a_pll pll;
	uint32_t ms_div;
	uint64_t vco;
	uint32_t pll_a, pll_b, pll_c;
	uint8_t r_div = 0;
	uint32_t freq = freq_hz;
	int ret;

	if (output >= SI5351A_OUTPUT_COUNT) {
		return -EINVAL;
	}

	if (freq_hz == 0 || freq_hz > 200000000UL) {
		LOG_ERR("Frequency %u Hz out of range", freq_hz);
		return -EINVAL;
	}

	/* PLL assignment: CLK0 → PLLA, CLK1/CLK2 → PLLB */
	pll = (output == 0) ? SI5351A_PLL_A : SI5351A_PLL_B;

	/* For low frequencies, use R output divider (/2^n) */
	while (freq < 1000000UL && r_div < 7) {
		freq *= 2;
		r_div++;
	}

	/* Pick an even integer multisynth divider */
	ms_div = (uint32_t)(SI5351_VCO_MAX / freq);
	if (ms_div > SI5351_MS_DIV_MAX) {
		ms_div = SI5351_MS_DIV_MAX;
	}
	if (ms_div < SI5351_MS_DIV_MIN + 2) {
		ms_div = SI5351_MS_DIV_MIN + 2;
	}
	ms_div &= ~1U;   /* Make even for lower jitter */

	/* Calculate required VCO frequency */
	vco = (uint64_t)freq * ms_div;

	/* Clamp VCO to valid range */
	if (vco < SI5351_VCO_MIN) {
		ms_div = (uint32_t)((SI5351_VCO_MIN + freq - 1) / freq);
		ms_div = (ms_div + 1) & ~1U;
		vco = (uint64_t)freq * ms_div;
	}
	if (vco > SI5351_VCO_MAX) {
		ms_div = (uint32_t)(SI5351_VCO_MAX / freq);
		ms_div &= ~1U;
		vco = (uint64_t)freq * ms_div;
	}

	/* PLL feedback: VCO = XTAL * (pll_a + pll_b/pll_c) */
	pll_a = (uint32_t)(vco / xtal);
	{
		uint64_t remainder = vco - (uint64_t)pll_a * xtal;
		uint32_t g;

		pll_c = xtal;
		pll_b = (uint32_t)remainder;

		/* Reduce fraction */
		g = gcd32(pll_b, pll_c);
		if (g > 1) {
			pll_b /= g;
			pll_c /= g;
		}

		/* Ensure denominator fits in 20 bits */
		while (pll_c > SI5351_P_MAX) {
			pll_b >>= 1;
			pll_c >>= 1;
			if (pll_c == 0) {
				pll_c = 1;
			}
		}
	}

	/* Validate PLL multiplier range */
	if (pll_a < SI5351_PLL_A_MIN || pll_a > SI5351_PLL_A_MAX) {
		LOG_ERR("Computed PLL mult %u out of range for freq %u Hz",
			pll_a, freq_hz);
		return -ERANGE;
	}

	LOG_INF("CLK%u → %u Hz: PLL%c=%u+%u/%u  MS=%u  R=/%u",
		output, freq_hz,
		(pll == SI5351A_PLL_A) ? 'A' : 'B',
		pll_a, pll_b, pll_c, ms_div, 1U << r_div);

	/* 1. Configure PLL */
	ret = si5351a_setup_pll(dev, pll, pll_a, pll_b, pll_c);
	if (ret < 0) {
		return ret;
	}

	/* 2. Configure Multisynth (integer mode, even divider) */
	ret = si5351a_setup_multisynth(dev, output, pll, ms_div, 0, 1, r_div);
	if (ret < 0) {
		return ret;
	}

	/* 3. Reset PLL to lock */
	ret = si5351a_pll_reset(dev, pll);
	if (ret < 0) {
		return ret;
	}

	/* 4. Enable output */
	ret = si5351a_output_enable(dev, output, true);

	return ret;
}

/* ===================================================================
 * PPB adjustment – tweak PLL fractional divider for fine-tuning
 *
 * Strategy:
 *   Re-use the same even MS divider from set_frequency().  Recompute
 *   the PLL fractional parameters for:
 *     freq_adjusted = base_freq_hz * (1 + ppb / 1e9)
 *   Since ppb is tiny, this only changes PLL numerator/denominator
 *   by a few LSBs.  No PLL reset is required – the Si5351 tracks
 *   the new frequency smoothly.
 * =================================================================== */

int si5351a_adjust_ppb(const struct device *dev, uint8_t output,
		       uint32_t base_freq_hz, int32_t ppb)
{
	const struct si5351a_config *cfg = dev->config;
	uint32_t xtal = cfg->xtal_freq;
	enum si5351a_pll pll;
	uint32_t ms_div;
	uint64_t vco;
	uint32_t pll_a, pll_b, pll_c;
	uint8_t r_div = 0;
	uint32_t freq = base_freq_hz;
	int ret;

	if (output >= SI5351A_OUTPUT_COUNT) {
		return -EINVAL;
	}
	if (base_freq_hz == 0 || base_freq_hz > 200000000UL) {
		return -EINVAL;
	}

	pll = (output == 0) ? SI5351A_PLL_A : SI5351A_PLL_B;

	/* Handle low frequencies via R divider */
	while (freq < 1000000UL && r_div < 7) {
		freq *= 2;
		r_div++;
	}

	/* Pick same even MS divider as set_frequency would */
	ms_div = (uint32_t)(SI5351_VCO_MAX / freq);
	if (ms_div > SI5351_MS_DIV_MAX) {
		ms_div = SI5351_MS_DIV_MAX;
	}
	if (ms_div < SI5351_MS_DIV_MIN + 2) {
		ms_div = SI5351_MS_DIV_MIN + 2;
	}
	ms_div &= ~1U;

	/* Clamp same as set_frequency */
	vco = (uint64_t)freq * ms_div;
	if (vco < SI5351_VCO_MIN) {
		ms_div = (uint32_t)((SI5351_VCO_MIN + freq - 1) / freq);
		ms_div = (ms_div + 1) & ~1U;
	}
	if (vco > SI5351_VCO_MAX) {
		ms_div = (uint32_t)(SI5351_VCO_MAX / freq);
		ms_div &= ~1U;
	}

	/*
	 * Compute adjusted VCO:
	 *   vco = freq * ms_div * (1 + ppb/1e9)
	 *       = freq * ms_div + freq * ms_div * ppb / 1e9
	 *
	 * Use 64-bit arithmetic to avoid overflow.
	 */
	{
		int64_t vco_base = (int64_t)freq * ms_div;
		int64_t vco_adj  = (vco_base * (int64_t)ppb) / 1000000000LL;

		vco = (uint64_t)(vco_base + vco_adj);
	}

	/* PLL feedback: VCO = XTAL * (pll_a + pll_b/pll_c) */
	pll_a = (uint32_t)(vco / xtal);
	{
		uint64_t remainder = vco - (uint64_t)pll_a * xtal;
		uint32_t g;

		pll_c = xtal;
		pll_b = (uint32_t)remainder;

		g = gcd32(pll_b, pll_c);
		if (g > 1) {
			pll_b /= g;
			pll_c /= g;
		}

		while (pll_c > SI5351_P_MAX) {
			pll_b >>= 1;
			pll_c >>= 1;
			if (pll_c == 0) {
				pll_c = 1;
			}
		}
	}

	if (pll_a < SI5351_PLL_A_MIN || pll_a > SI5351_PLL_A_MAX) {
		LOG_ERR("PPB adjust: PLL mult %u out of range", pll_a);
		return -ERANGE;
	}

	LOG_DBG("PPB adj CLK%u: ppb=%d PLL%c=%u+%u/%u MS=%u",
		output, ppb,
		(pll == SI5351A_PLL_A) ? 'A' : 'B',
		pll_a, pll_b, pll_c, ms_div);

	/* Update PLL only – no MS change, no PLL reset for glitch-free tuning */
	ret = si5351a_setup_pll(dev, pll, pll_a, pll_b, pll_c);

	return ret;
}

/* ===================================================================
 * Initialisation – follows the recommended startup sequence
 * from the Si5351 datasheet §5:
 *
 *  1. Wait for SYS_INIT to clear (device ready)
 *  2. Disable all outputs (reg 3 = 0xFF)
 *  3. Power down all output drivers
 *  4. Set crystal load capacitance
 *  5. (Application will configure PLLs/MS via API)
 *  6. Enable MS and XO fanout
 * =================================================================== */

static int si5351a_init(const struct device *dev)
{
	const struct si5351a_config *cfg = dev->config;
	struct si5351a_data *data = dev->data;
	uint8_t status;
	int ret;
	int retries = 50;  /* ~500 ms timeout */

	if (!i2c_is_ready_dt(&cfg->i2c)) {
		LOG_ERR("I2C bus not ready");
		return -ENODEV;
	}

	LOG_INF("Si5351A init on I2C addr 0x%02X, XTAL=%u Hz",
		cfg->i2c.addr, cfg->xtal_freq);

	/* 1. Wait for SYS_INIT to clear */
	do {
		ret = si5351_read_reg(&cfg->i2c, SI5351_REG_DEV_STATUS, &status);
		if (ret < 0) {
			LOG_ERR("Failed to read device status: %d", ret);
			return ret;
		}
		if (!(status & SI5351_STATUS_SYS_INIT)) {
			break;
		}
		k_msleep(10);
	} while (--retries > 0);

	if (retries == 0) {
		LOG_ERR("Si5351A SYS_INIT did not clear (status=0x%02X)", status);
		return -ETIMEDOUT;
	}

	/* 2. Disable all outputs */
	ret = si5351_write_reg(&cfg->i2c, SI5351_REG_OUTPUT_EN, 0xFF);
	if (ret < 0) {
		return ret;
	}

	/* 3. Power down all output drivers */
	for (int i = 0; i < SI5351A_OUTPUT_COUNT; i++) {
		data->clk_ctrl[i] = SI5351_CLK_PDN | SI5351_CLK_IDRV_8MA;
		ret = si5351_write_reg(&cfg->i2c, clk_ctrl_reg(i),
				       data->clk_ctrl[i]);
		if (ret < 0) {
			return ret;
		}
	}

	/* 4. Set crystal load capacitance */
	ret = si5351_write_reg(&cfg->i2c, SI5351_REG_XTAL_CL, cfg->xtal_load);
	if (ret < 0) {
		return ret;
	}

	/* 5. Enable MS and XO fanout */
	ret = si5351_write_reg(&cfg->i2c, SI5351_REG_FANOUT_EN,
			       SI5351_FANOUT_MS_EN | SI5351_FANOUT_XO_EN);
	if (ret < 0) {
		return ret;
	}

	/* Clear cached VCO frequencies */
	data->pll_vco[0] = 0;
	data->pll_vco[1] = 0;

	LOG_INF("Si5351A initialised successfully");
	return 0;
}

/* ===================================================================
 * Device instantiation macros
 * =================================================================== */

/*
 * Compile-time macro to convert DT xtal-load-pf (6/8/10) to register value.
 * Must be a constant expression for static initialiser.
 */
#define SI5351A_XTAL_LOAD_REG(pf)                          \
	((pf) == 6  ? SI5351_XTAL_CL_6PF  :               \
	 (pf) == 8  ? SI5351_XTAL_CL_8PF  :               \
	              SI5351_XTAL_CL_10PF)

#define SI5351A_DEFINE(inst)                                               \
	static struct si5351a_data si5351a_data_##inst;                    \
	static const struct si5351a_config si5351a_cfg_##inst = {          \
		.i2c = I2C_DT_SPEC_INST_GET(inst),                        \
		.xtal_freq = DT_INST_PROP(inst, clock_frequency),          \
		.xtal_load = SI5351A_XTAL_LOAD_REG(                       \
			DT_INST_PROP_OR(inst, silabs_xtal_load_pf, 10)),  \
	};                                                                 \
	DEVICE_DT_INST_DEFINE(inst, si5351a_init, NULL,                    \
			      &si5351a_data_##inst,                        \
			      &si5351a_cfg_##inst,                         \
			      POST_KERNEL,                                 \
			      CONFIG_SI5351A_INIT_PRIORITY,                \
			      NULL);

DT_INST_FOREACH_STATUS_OKAY(SI5351A_DEFINE)
