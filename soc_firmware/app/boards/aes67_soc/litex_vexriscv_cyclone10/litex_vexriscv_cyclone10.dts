/*
 * AES67 LiteX VexRiscv on Cyclone 10 LP (c10_evalkit), 8 MB HyperRAM.
 *
 * SPDX-License-Identifier: Apache-2.0
 */

/dts-v1/;

#include <riscv32-litex-vexriscv.dtsi>

/ {
	model = "AES67 LiteX VexRiscv (Cyclone 10LP / HyperRAM)";
	compatible = "aes67,litex-vexriscv-cyclone10", "litex,vexriscv";

	ram0: memory@20000000 {
		device_type = "memory";
		/* size overridden by generated CSR dtsi */
		reg = <0x20000000 0x00800000>;
	};
};

/* Hand-written AES67 peripherals shared across all LiteX variants.
 * Must come first: declares labels (uart1, i2c_card, eth_buf, …) that the
 * generated dtsi then overrides with the correct register addresses. */
#include "../litex_vexriscv_common.dtsi"

/* Auto-generated per-target addresses (from litex_soc/build/cyclone10/csr.json). */
#include "litex_vexriscv_cyclone10_csr.dtsi"
