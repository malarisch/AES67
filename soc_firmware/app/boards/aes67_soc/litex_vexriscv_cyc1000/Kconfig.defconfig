## soc_firmware/app/boards/aes67_soc/litex_vexriscv_cyc1000/Kconfig.defconfig
```kconfig
if BOARD_LITEX_VEXRISCV_CYC1000

if NETWORKING

config NET_L2_ETHERNET
	default y

endif # NETWORKING

endif # BOARD_LITEX_VEXRISCV_CYC1000
```

## soc_firmware/app/boards/aes67_soc/litex_vexriscv_cyc1000/board.yml
```yaml
board:
  name: litex_vexriscv_cyc1000
  full_name: AES67 LiteX VexRiscv (Arrow CYC1000, SDRAM)
  vendor: aes67_soc
  socs:
  - name: litex_vexriscv
```

## soc_firmware/app/boards/aes67_soc/litex_vexriscv_cyc1000/litex_vexriscv_cyc1000_defconfig
```kconfig
CONFIG_CONSOLE=y
CONFIG_SERIAL=y
CONFIG_UART_CONSOLE=y
CONFIG_GPIO=y
CONFIG_XIP=n
CONFIG_CLOCK_CONTROL=y
CONFIG_HEAP_MEM_POOL_SIZE=4096
CONFIG_SPI_NOR_SFDP_RUNTIME=y
```

## soc_firmware/app/boards/aes67_soc/litex_vexriscv_cyclone10/Kconfig.defconfig
```kconfig
if BOARD_LITEX_VEXRISCV_CYCLONE10

if NETWORKING

config NET_L2_ETHERNET
	default y

endif # NETWORKING

endif # BOARD_LITEX_VEXRISCV_CYCLONE10
```

## soc_firmware/app/boards/aes67_soc/litex_vexriscv_cyclone10/board.yml
```yaml
board:
  name: litex_vexriscv_cyclone10
  full_name: AES67 LiteX VexRiscv (Cyclone 10LP, HyperRAM)
  vendor: aes67_soc
  socs:
  - name: litex_vexriscv
```

## soc_firmware/app/boards/nucleo_h753zi.conf
```kconfig
# STM32H753ZI board-specific Kconfig
# FMC Ethernet bridge to FPGA
CONFIG_ETH_FMC_BASIC=y
CONFIG_ETH_STM32_HAL=n
CONFIG_ETH_FMC_BASIC_RX_STACK_SIZE=4096

# Cache management for DMA
CONFIG_NOCACHE_MEMORY=y

# FMC controller for FPGA memory-mapped access
CONFIG_MEMC=y
CONFIG_MEMC_STM32=y
CONFIG_MEMC_STM32_NOR_PSRAM=y

# STM32 has hardware entropy
CONFIG_ENTROPY_GENERATOR=y

# FPGA HAL — FMC backend
CONFIG_FPGA_HAL=y
CONFIG_FPGA_HAL_FMC=y
```

## soc_firmware/app/drivers/Kconfig
```kconfig
menu "Drivers"
rsource "eth_litex/Kconfig.litex"
rsource "spibone/Kconfig.spibone"
rsource "fpga_jtag/Kconfig.fpga_jtag"
rsource "eth_spi/Kconfig.eth_spi"
rsource "fpga_hal/Kconfig.fpga_hal"
rsource "si5351a/Kconfig.si5351a"
rsource "mi_card/Kconfig.mi_card"
rsource "lo_card/Kconfig.lo_card"
rsource "io_card/Kconfig.io_card"
rsource "display_ctrl/Kconfig.display_ctrl"
rsource "spi_flash/Kconfig.spi_flash"
endmenu
```

## soc_firmware/app/drivers/auracast_card/Kconfig.auracast_card
```kconfig
# SPDX-License-Identifier: Apache-2.0

config AURACAST_CARD
	bool "Auracast transmitter card (ESP32-S31) driver"
	depends on I2C
	help
	  Enable the driver for the Auracast card: an ESP32-S31 that turns
	  the FPGA's I2S output into a Bluetooth LE Audio broadcast. The S31
	  is an I2C slave (default address 0x3A) with a register protocol
	  (auracast_i2c_regs.h). The driver configures and starts the
	  broadcast once the PTP lock is seen, polls the S31's status once
	  per second and reconfigures it after an unexpected S31 restart.

if AURACAST_CARD

config AURACAST_CARD_LOG_LEVEL
	int "Auracast card driver log level"
	default 3
	range 0 4
	help
	  0 = OFF, 1 = ERR, 2 = WRN, 3 = INF, 4 = DBG

config AURACAST_CARD_I2C_ADDR
	hex "Auracast card I2C address (7-bit)"
	default 0x3A
	help
	  7-bit I2C slave address of the S31 (AURA_I2C_DEFAULT_ADDR in the
	  protocol header; Kconfig on the S31 side).

endif # AURACAST_CARD
```

## soc_firmware/app/drivers/display_ctrl/Kconfig.display_ctrl
```kconfig
# SPDX-License-Identifier: Apache-2.0

config DISPLAY_CTRL
	bool "Display Controller (LEDs, Buttons, 7-Segment)"
	depends on UART_INTERRUPT_DRIVEN
	help
	  Enable driver for the front panel display controller.
	  
	  Communication is via UART at 115200 baud.

if DISPLAY_CTRL

config DISPLAY_CTRL_LOG_LEVEL
	int "Display controller log level"
	default 3
	range 0 4
	help
	  Log level for display controller driver.
	  0 = OFF, 1 = ERR, 2 = WRN, 3 = INF, 4 = DBG

config DISPLAY_CTRL_INIT_PRIORITY
	int "Display controller initialization priority"
	default 85
	help
	  Device driver initialization priority.
	  Must be initialized after UART.

config DISPLAY_CTRL_UART_BAUD
	int "UART baud rate"
	default 115200
	help
	  Baud rate for communication with the display controller.

config DISPLAY_CTRL_NUM_CHANNELS
	int "Number of channel LEDs"
	default 8
	range 8 24
	help
	  Number of channel LEDs supported by the front panel.
	  8 for standard cards (MI, LO), 24 for 16in/8out cards (IO, OI).
	  When set to more than 8, the driver uses the extended
	  multi-layer UART addressing scheme.

config DISPLAY_CTRL_AUTO_SYNC_MI_CARD
	bool "Auto-sync with MI card driver"
	default y
	depends on MI_CARD
	help
	  Automatically update 48V and Mute LEDs when MI card
	  phantom and mute states change.

config DISPLAY_CTRL_NRST_GPIO
	bool "Enable hardware reset via shared nRST GPIO"
	default n
	depends on GPIO
	help
	  Enable hardware reset functionality via a dedicated GPIO pin.
	  The GPIO is active-low (asserted low to reset).

	  NOTE: The nRST line is shared between the display controller
	  and the IO card.  A hardware reset will reset BOTH devices.
	  Other drivers can register post-reset callbacks via
	  display_ctrl_register_nrst_callback().

	  Use this on STM32H7 boards where nRST is a direct GPIO.

config DISPLAY_CTRL_NRST_HAL
	bool "Enable hardware reset via FPGA HAL (CSR)"
	default y
	depends on FPGA_HAL_LITEX
	help
	  Enable hardware reset via the FPGA HAL adda_nrst CSR bit.
	  The nRST line is shared between the display controller
	  and the IO card.

	  Use this on LiteX boards where nRST is an FPGA output
	  controlled via fpga_hal_set_adda_nrst().

config DISPLAY_CTRL_NRST_PULSE_MS
	int "nRST pulse duration in milliseconds"
	default 50
	range 1 500
	depends on DISPLAY_CTRL_NRST_GPIO || DISPLAY_CTRL_NRST_HAL
	help
	  Duration of the reset pulse in milliseconds.

config DISPLAY_CTRL_NRST_RECOVERY_MS
	int "Post-reset recovery time in milliseconds"
	default 200
	range 10 1000
	depends on DISPLAY_CTRL_NRST_GPIO || DISPLAY_CTRL_NRST_HAL
	help
	  Time to wait after releasing reset before UART communication.

endif # DISPLAY_CTRL
```

## soc_firmware/app/drivers/eth_litex/Kconfig.litex
```kconfig
menuconfig ETH_LITEX
	bool "LiteX SoC Ethernet interface"
	select NET_L2_ETHERNET
	help
	  Ethernet driver for the LiteX-generated AES67 SoC.
	  Uses CSR registers for control/status and a Wishbone-mapped
	  dual-port packet buffer (1500 bytes RX + 1500 bytes TX).

if ETH_LITEX

config ETH_LITEX_MAC_ADDR
	string "MAC address (XX:XX:XX:XX:XX:XX)"
	default "02:1C:23:17:AC:AB"
	help
	  Locally-administered MAC address used by the LiteX Ethernet
	  driver. Override per board in the board .conf file when
	  running multiple units on the same network — duplicate MACs
	  cause ARP/IGMP havoc. Bit 1 of the first byte should be set
	  to mark the address as locally administered.

config ETH_LITEX_POLL_INTERVAL_MS
	int "RX poll interval (ms)"
	default 100
	help
	  Fallback polling interval when no IRQ fires. The driver
	  uses k_sem_take with this timeout, so actual RX latency
	  is typically much lower when the IRQ is working.

config ETH_LITEX_RX_STACK_SIZE
	int "RX/TX thread stack size"
	default 2048
	help
	  Stack size for RX and TX worker threads.

config ETH_LITEX_TX_QUEUE_DEPTH
	int "TX packet queue depth"
	default 16
	help
	  Number of packets that can be queued for transmission.
	  Increase this if the device handles bursty TCP traffic
	  (e.g. a web server serving multiple browser connections).

endif # ETH_LITEX
```

## soc_firmware/app/drivers/eth_spi/Kconfig.eth_spi
```kconfig
menuconfig ETH_SPI
	bool "Ethernet over FPGA SPI (spibone)"
	depends on SPIBONE && NET_L2_ETHERNET
	help
	  Zephyr Ethernet driver that uses the spibone bus driver to
	  exchange frames with the FPGA's litex_eth_buffer_bridge packet
	  buffers (eth_buf memory + rx_len/rx_ack/tx_len CSRs). An IRQ
	  GPIO connected to the FPGA's `mcu_irq_o` line (eth_buf RX-ready
	  event) wakes the RX thread.

if ETH_SPI

module = ETH_SPI
module-str = eth_spi
source "subsys/logging/Kconfig.template.log_config"

config ETH_SPI_RX_STACK_SIZE
	int "RX/TX thread stack size"
	default 2048
	help
	  Stack size for the RX and TX worker threads.

config ETH_SPI_TX_QUEUE_DEPTH
	int "TX packet queue depth"
	default 8
	help
	  Number of outbound packets that can be queued while the TX
	  thread is busy.

config ETH_SPI_POLL_INTERVAL_MS
	int "Fallback RX poll interval (ms)"
	default 500
	help
	  Upper bound for RX latency if the IRQ line is not wired or
	  fires spuriously. The RX thread uses this as the timeout on
	  the semaphore it waits on. Lower for tighter latency at the
	  cost of SPI bus occupancy.

config ETH_SPI_INIT_PRIORITY
	int "Driver init priority"
	default 81
	help
	  Must run after CONFIG_SPIBONE_INIT_PRIORITY (default 60) and
	  after the SPI controller (typically 50).

endif # ETH_SPI
```

## soc_firmware/app/drivers/fpga_hal/Kconfig.fpga_hal
```kconfig
menuconfig FPGA_HAL
	bool "FPGA Hardware Abstraction Layer"
	help
	  Common abstraction layer for FPGA register access.
	  Exactly one backend must be selected.

if FPGA_HAL

choice FPGA_HAL_BACKEND
	prompt "FPGA HAL backend"
	default FPGA_HAL_LITEX if ETH_LITEX
	default FPGA_HAL_SPI if SPIBONE
	default FPGA_HAL_MOCK

config FPGA_HAL_LITEX
	bool "LiteX CSR backend"
	depends on ETH_LITEX
	help
	  Use LiteX CSR registers for FPGA register access.

config FPGA_HAL_SPI
	bool "SPI backend (external MCU, spibone)"
	depends on SPIBONE
	help
	  Reach the aes67_bridge CSR map over the LiteX spibone
	  SPI-to-Wishbone bridge. Intended for boards where Zephyr runs
	  on an external MCU (e.g. ESP32-S3) and drives CPU-less FPGA
	  gateware over SPI.

config FPGA_HAL_MOCK
	bool "Mock backend (QEMU / CI, no hardware)"
	help
	  Emulate the aes67_bridge register map in RAM: sparse CSR
	  register file, synthetic monotonic TAI wallclock, system_cfg
	  CSRs pre-populated from the FPGA_HAL_MOCK_* options. Lets the
	  full control plane (streams, discovery, NMOS, web API, PTP
	  BMC) run on emulated boards such as qemu_x86 for CI.

endchoice

if FPGA_HAL_MOCK

config FPGA_HAL_MOCK_TX_STREAMS
	int "Mock gateware: TX stream slots"
	range 0 8
	default 8

config FPGA_HAL_MOCK_TX_CHANNELS
	int "Mock gateware: physical AD input channels"
	range 0 16
	default 8

config FPGA_HAL_MOCK_RX_STREAMS
	int "Mock gateware: RX stream slots"
	range 0 8
	default 8

config FPGA_HAL_MOCK_RX_CHANNELS
	int "Mock gateware: physical DA output channels"
	range 0 16
	default 8

config FPGA_HAL_MOCK_GOLDFISH_RTC
	bool "Wallclock from QEMU's Goldfish RTC (host real time)"
	default y if BOARD_QEMU_RISCV64
	help
	  Serve the mock PTP wallclock from the Goldfish RTC that QEMU's
	  virt machine provides at a fixed MMIO address (host
	  CLOCK_REALTIME + 37 s leap-second offset = TAI). Keeps the
	  emulated node's TAI in sync with the test host, which the
	  absolute scheduled activations of the IS-05/IS-08 conformance
	  suites require. Without this the wallclock free-runs from a
	  fixed 2026 epoch.

config FPGA_HAL_MOCK_GOLDFISH_RTC_BASE
	hex "Goldfish RTC MMIO base"
	depends on FPGA_HAL_MOCK_GOLDFISH_RTC
	default 0x101000
	help
	  MMIO base of the Goldfish RTC (0x101000 on qemu -machine virt
	  for RISC-V).

endif # FPGA_HAL_MOCK

config FPGA_HAL_SHELL
	bool "FPGA HAL shell commands"
	depends on SHELL
	default y
	help
	  Register an `fpga` shell command tree that exposes the HAL read
	  and write APIs (status, mac, ip, ptp, gm, ctrl set/clear, adda,
	  meter, tx, rx). Works with every HAL backend.

config AES67_SPIBONE_PROBE
	bool "Probe the spibone bus at boot (scratch-register sanity check)"
	depends on FPGA_HAL_SPI
	default y
	help
	  After the drivers come up, read the LiteX ctrl scratch register
	  (known reset value 0x12345678, when present) and round-trip a set
	  of patterns through the AES67 scratch register, logging whether
	  the spibone Wishbone bus actually responds. Turns a silent "FPGA
	  doesn't respond" into a definite bus-up/bus-down verdict before
	  the reset-staging in main() (which reads the reset CSR over the
	  same bus) runs. Cheap; leave on for bring-up.

endif # FPGA_HAL
```
