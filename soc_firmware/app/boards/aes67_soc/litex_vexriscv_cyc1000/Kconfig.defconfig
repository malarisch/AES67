## soc_firmware/app/drivers/fpga_jtag/Kconfig.fpga_jtag
```kconfig
config AES67_FPGA_JTAG
	bool "Cyclone FPGA JTAG bit-bang (chain scan / configuration)"
	default y
	depends on DT_HAS_AES67_CYCLONE_JTAG_ENABLED
	depends on GPIO
	help
	  Bit-bang the FPGA's JTAG interface (TCK/TMS/TDI/TDO on GPIOs,
	  devicetree node compatible "aes67,cyclone-jtag"). This first stage
	  scans the chain and reads IDCODEs to verify the wiring and identify
	  the device; JTAG SRAM configuration is a later addition.

if AES67_FPGA_JTAG

config AES67_FPGA_JTAG_SCAN_AT_BOOT
	bool "Scan the JTAG chain at boot and log the IDCODEs"
	default y
	help
	  Run a chain scan during driver init and log the devices found.
	  Useful for bringing up hand-wired JTAG before any configuration
	  logic exists. Ignored when AES67_FPGA_JTAG_BOOT_LOAD is set (that
	  path scans and verifies the device itself before configuring).

config AES67_FPGA_JTAG_BOOT_LOAD
	bool "Configure the FPGA over JTAG at boot from an embedded bitstream"
	help
	  Extract the JTAG configuration data from the SVF named by
	  AES67_FPGA_JTAG_BITSTREAM, embed it into the firmware image and
	  load it into the FPGA's SRAM over JTAG during driver init — before
	  spibone, eth_spi or the FPGA HAL touch the device. The chain is
	  scanned and the IDCODE verified first, so a mis-wired or unexpected
	  device is never configured blind.

config AES67_FPGA_JTAG_BITSTREAM
	string "Path to the Quartus JTAG SVF"
	depends on AES67_FPGA_JTAG_BOOT_LOAD
	default "../../FPGA/boards/altera/cyc2/output_files/cyc2.svf"
	help
	  Serial Vector Format file produced by Quartus for JTAG
	  configuration of the FPGA (Programmer -> File -> Create
	  JAM/SVF/JBC File, SVF, JTAG mode). Altera organises the JTAG
	  configuration bitstream differently from the serial RBF, so the RBF
	  cannot be shifted over JTAG; the build extracts the config data
	  blob from the SVF (svf_to_bin.py) and embeds it into flash rodata.
	  A relative path is resolved against the application source
	  directory. Regenerate the SVF whenever the gateware changes.

config AES67_FPGA_JTAG_CONFIG_RETRIES
	int "JTAG configuration attempts (verified by USERCODE read-back)"
	depends on AES67_FPGA_JTAG_BOOT_LOAD
	default 8
	range 1 32
	help
	  After each configuration pass the device's USERCODE register is
	  read back and compared to the value embedded from the SVF. On a
	  mismatch (a bit error corrupted the shift) the configuration is
	  retried up to this many times. This masks intermittent TDI/TCK
	  signal-integrity errors on hand-wired JTAG; each attempt reshifts
	  the full bitstream, so keep an eye on how many are needed and fix
	  the wiring / raise AES67_FPGA_JTAG_TCK_DELAY_US if it is more than
	  a couple.

config AES67_FPGA_JTAG_LINK_TEST_BITS
	int "JTAG BYPASS link-test length in bits (0 = off)"
	depends on AES67_FPGA_JTAG_BOOT_LOAD
	default 20000
	range 0 2000000
	help
	  Before configuring, shift this many pseudo-random bits through the
	  device's 1-bit BYPASS register and count how many come back wrong.
	  This runs the exact TCK/TDI/TDO wiring the configuration stream uses
	  and reports its bit-error count, so a marginal hand-wired chain shows
	  up as a hard number instead of an intermittent config failure. Any
	  non-zero result means the wiring cannot carry the bitstream yet —
	  raise AES67_FPGA_JTAG_TCK_DELAY_US and improve the wiring until it is
	  zero. Set to 0 to skip the test once the link is known good.

config AES67_FPGA_JTAG_MONITOR
	bool "Poll the FPGA's health over JTAG and reconfigure on fault"
	depends on AES67_FPGA_JTAG_BOOT_LOAD
	default y
	help
	  Provide a monitor thread (started by the application via
	  fpga_jtag_monitor_start()) that periodically checks the FPGA over
	  JTAG: the IDCODE proves the chain works, the USERCODE proves the
	  configuration is still the embedded bitstream, and a SAMPLE
	  boundary scan reads the dual-purpose CRC_ERROR pin, which the
	  device latches high when its background CRC check finds corrupted
	  configuration SRAM (SEU; requires CRC_ERROR_CHECKING ON in the
	  Quartus .qsf). A confirmed fault fires the registered event
	  callback (mute the outputs there), force-reloads the bitstream and
	  reports the outcome so the application can finish recovery
	  (typically a reboot for a clean bring-up).

config AES67_FPGA_JTAG_MONITOR_INTERVAL_MS
	int "Health-check interval in milliseconds"
	depends on AES67_FPGA_JTAG_MONITOR
	default 1000
	range 100 60000
	help
	  One check is ~1300 bit-banged TCK cycles (a few milliseconds), so
	  the default 1 s costs well under 1 % CPU.

config AES67_FPGA_JTAG_MONITOR_STACK_SIZE
	int "Monitor thread stack size in bytes"
	depends on AES67_FPGA_JTAG_MONITOR
	default 4096
	help
	  The thread runs the application's fault callback (card mute over
	  I2C, display updates) and the full JTAG bitstream reload, so the
	  stack must cover the deepest of those call chains, not just the
	  monitor loop itself.

config AES67_FPGA_JTAG_TCK_DELAY_US
	int "TCK half-period in microseconds (bit-bang)"
	default 1
	range 0 100
	help
	  Delay inserted on each TCK half-cycle. 0 clocks as fast as the
	  GPIO calls allow (hundreds of kHz on the ESP32); increase it if a
	  marginally wired chain needs a slower clock. The uncompressed
	  bitstream is a few Mbit, so this directly sets the boot-time
	  configuration duration.

config AES67_FPGA_JTAG_INIT_PRIORITY
	int "Init priority of the JTAG driver"
	default 55
	help
	  After GPIO init and, once JTAG configuration is added, below the
	  FPGA consumers (spibone at CONFIG_SPIBONE_INIT_PRIORITY, default
	  60) so a JTAG-loaded bitstream is in place before the first
	  Wishbone transaction.

endif # AES67_FPGA_JTAG
```

## soc_firmware/app/drivers/fpga_spi/Kconfig.fpga_spi
```kconfig
config FPGA_SPI
	bool "FPGA SPI register driver"
	depends on SPI
	help
	  Enable the SPI driver that talks to the on-FPGA spictrl block
	  (see FPGA/spictrl.vhd). Requires a chosen node
	  `zephyr,fpga-spi` pointing at the SPI slave representing the
	  FPGA on the bus.

if FPGA_SPI

module = FPGA_SPI
module-str = fpga_spi
source "subsys/logging/Kconfig.template.log_config"

config FPGA_SPI_INIT_PRIORITY
	int "FPGA SPI driver init priority"
	default 60
	help
	  Must run after the SPI controller (typically 50) and before
	  the FPGA HAL backend that uses it.

endif # FPGA_SPI
```

## soc_firmware/app/drivers/io_card/Kconfig.io_card
```kconfig
# SPDX-License-Identifier: Apache-2.0

config IO_CARD
	bool "IO Card 16-in/8-out analog I/O board driver"
	depends on I2C
	help
	  Enable driver for the IO card with 16 analog inputs (ADC preamp)
	  and 8 analog outputs (DAC line output).

	  Input side: 2x LPC controllers (0x40, 0x41) and 2x CS5368 ADCs
	  (0x4C, 0x4D) directly on the I2C bus.

	  Output side: LPC controller (0x43) and 1x CS4385 DAC (0x18)
	  with 8 output channels, accessed directly on the I2C bus.

if IO_CARD

config IO_CARD_LOG_LEVEL
	int "IO card driver log level"
	default 3
	range 0 4
	help
	  Log level for IO card driver.
	  0 = OFF, 1 = ERR, 2 = WRN, 3 = INF, 4 = DBG

config IO_CARD_MUX_ADDR
	hex "I2C address of the output-side MUX device"
	default 0x70
	help
	  I2C address of the PCA9540B / TCA9543A-compatible 2-channel
	  I2C multiplexer used to reach the output LPC and DAC chips.

endif # IO_CARD
```

## soc_firmware/app/drivers/lo_card/Kconfig.lo_card
```kconfig
# SPDX-License-Identifier: Apache-2.0

config LO_CARD
	bool "LO Card 8-channel DAC line output board driver"
	depends on I2C
	help
	  Enable driver for the LO 8-channel DAC line output board.
	  This board has an LPC microcontroller (at I2C address 0x40)
	  controlling output enable and muting, plus a DSP chip
	  (at I2C address 0x14) and 4x DAC devices (0x4C-0x4F).

if LO_CARD

config LO_CARD_LOG_LEVEL
	int "LO card driver log level"
	default 3
	range 0 4
	help
	  Log level for LO card driver.
	  0 = OFF, 1 = ERR, 2 = WRN, 3 = INF, 4 = DBG

config LO_CARD_INIT_PRIORITY
	int "LO card driver initialization priority"
	default 80
	help
	  Device driver initialization priority for LO card.
	  Must be initialized after I2C bus.

config LO_CARD_NRST_GPIO
	bool "Enable hardware reset via nRST GPIO"
	default y
	depends on GPIO
	help
	  Enable hardware reset functionality via a dedicated GPIO pin.
	  The GPIO is active-low (asserted low to reset the board).

config LO_CARD_NRST_PULSE_MS
	int "nRST pulse duration in milliseconds"
	default 100
	range 1 100
	depends on LO_CARD_NRST_GPIO
	help
	  Duration of the reset pulse in milliseconds.

config LO_CARD_NRST_RECOVERY_MS
	int "Post-reset recovery time in milliseconds"
	default 1000
	range 10 1000
	depends on LO_CARD_NRST_GPIO
	help
	  Time to wait after releasing reset before accessing I2C.
	  The board needs time to initialize its internal PLLs/clocks.

config LO_CARD_I2C_RETRIES
	int "I2C retry count for failed transactions"
	default 10
	range 1 20
	help
	  Number of retry attempts for I2C operations that fail.
	  The old firmware used 10 retries with verify-after-write.

config LO_CARD_I2C_RETRY_DELAY_MS
	int "Delay between I2C retries in milliseconds"
	default 5
	range 1 50
	help
	  Delay before retrying a failed I2C transaction.

config LO_CARD_I2C_VERIFY_WRITES
	bool "Verify I2C writes by reading back"
	default y
	help
	  After each write, read back the data to verify it was
	  written correctly. This matches the old firmware behavior
	  (TwiSecureWrite) and improves reliability.

endif # LO_CARD
```

## soc_firmware/app/drivers/mi_card/Kconfig.mi_card
```kconfig
# SPDX-License-Identifier: Apache-2.0

config MI_CARD
	bool "MI Card 8-channel preamp board driver"
	depends on I2C
	help
	  Enable driver for the MI 8-channel ADC preamp board.
	  This board has an LPC microcontroller (at I2C address 0x40)
	  controlling preamp gain and phantom power, plus a DSP chip
	  (at I2C address 0x14).

if MI_CARD

config MI_CARD_LOG_LEVEL
	int "MI card driver log level"
	default 3
	range 0 4
	help
	  Log level for MI card driver.
	  0 = OFF, 1 = ERR, 2 = WRN, 3 = INF, 4 = DBG

config MI_CARD_INIT_PRIORITY
	int "MI card driver initialization priority"
	default 80
	help
	  Device driver initialization priority for MI card.
	  Must be initialized after I2C bus.

endif # MI_CARD
```

## soc_firmware/app/drivers/si5351a/Kconfig.si5351a
```kconfig
# Si5351A I2C Clock Generator driver

menuconfig SI5351A
	bool "Si5351A I2C Programmable Clock Generator"
	depends on I2C
	help
	  Enable driver for Silicon Labs Si5351A I2C programmable
	  any-frequency CMOS clock generator. Supports 3 independent
	  clock outputs (CLK0, CLK1, CLK2) derived from an external
	  crystal (25 MHz or 27 MHz) via two PLLs and per-output
	  multisynth fractional dividers.

if SI5351A

config SI5351A_INIT_PRIORITY
	int "Si5351A init priority"
	default 70
	help
	  Device driver initialization priority for the Si5351A.
	  Must be higher (later) than the I2C bus driver priority
	  so that the I2C bus is available at init time.

endif # SI5351A
```

## soc_firmware/app/drivers/spi_flash/Kconfig.spi_flash
```kconfig
config SPI_FLASH_LITESPI
	bool "SPI NOR Flash via LiteSPI master (W25Q64)"
	depends on FPGA_HAL_LITEX
	help
	  Enable in-system read/write access to the SPI NOR flash
	  via the LiteSPI master CSR interface. Requires the LiteX
	  SoC to instantiate the SpiFlash master CSR block — either
	  the stock `spiflash_master` (RAM-copy boot targets) or the
	  BIOS-invisible `spiflash_ctrl` (XIP-boot targets, cyc1000).
```

## soc_firmware/app/drivers/spibone/Kconfig.spibone
```kconfig
config SPIBONE
	bool "spibone Wishbone-over-SPI bridge driver"
	depends on SPI
	help
	  Transport driver for the LiteX spibone SPI-to-Wishbone bridge
	  (litex_soc/spi_bone.py) that fronts the aes67_bridge register
	  set on CPU-less gateware. Requires a chosen node
	  `zephyr,fpga-spi` pointing at the SPI slave representing the
	  FPGA on the bus. Same wire protocol as the Linux kernel driver
	  (driver/aes67_eth/aes67_bus.c) and the Rust config_tool.

if SPIBONE

module = SPIBONE
module-str = spibone
source "subsys/logging/Kconfig.template.log_config"

config SPIBONE_INIT_PRIORITY
	int "spibone driver init priority"
	default 60
	help
	  Must run after the SPI controller (typically 50) and before
	  the FPGA HAL backend and eth_spi driver that use it.

config SPIBONE_BURST
	bool "Use spibone burst transfers (commands 0x02/0x03)"
	default y
	help
	  Stream whole frames with the repo-local spibone fork's
	  auto-incrementing burst commands instead of one SPI round-trip
	  per 32-bit word. Disable only when the loaded FPGA gateware
	  predates burst support (every burst would otherwise time out).

config SPIBONE_STATS
	bool "Bus utilization statistics (`spibus` shell command)"
	default y if SHELL
	help
	  Account bus-mutex wait/hold time and SPI wire time per
	  transaction (two k_cycle_get_32() reads per lock/transfer).
	  The `spibus` shell command prints utilization, contention and
	  throughput as deltas since its previous invocation — the
	  CPU-bound-vs-SPI-bound measurement for the multicore
	  evaluation.

endif # SPIBONE
```
