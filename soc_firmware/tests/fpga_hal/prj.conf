## CMakeLists.txt
```
# Unit tests for the FPGA HAL: the mock register-map backend that the
# QEMU/CI firmware image runs on, the backend-neutral system_cfg parser
# on top of it, and the PPB arithmetic in fpga_regs.
#
# Keeping the mock under test matters twice over: a wrong emulation
# makes every higher-level QEMU test (NMOS conformance included) assert
# against fiction.

cmake_minimum_required(VERSION 3.20.0)
include(${CMAKE_CURRENT_SOURCE_DIR}/../sdk_qemu.cmake)
find_package(Zephyr REQUIRED HINTS $ENV{ZEPHYR_BASE})
project(aes67_fpga_hal_test)

set(APP_DIR ${CMAKE_CURRENT_SOURCE_DIR}/../../app)

add_subdirectory(${APP_DIR}/drivers ${CMAKE_CURRENT_BINARY_DIR}/app_drivers)

target_sources(app PRIVATE
  src/test_fpga_hal_mock.c
  src/test_fpga_syscfg.c
  src/test_fpga_regs.c

  ${APP_DIR}/src/fpga_regs.c
)

target_include_directories(app PRIVATE
  ${APP_DIR}/src
  ${APP_DIR}/drivers
  ${APP_DIR}/drivers/fpga_hal
)
```

## Kconfig
```
rsource "../../app/drivers/Kconfig"

source "Kconfig.zephyr"
```

## prj.conf
```kconfig
CONFIG_ZTEST=y

# fpga_regs writes the interface MAC/IP, so it needs the net types.
CONFIG_NETWORKING=y
CONFIG_NET_IPV4=y
CONFIG_NET_IPV6=n
CONFIG_NET_UDP=y
CONFIG_NET_SOCKETS=y

CONFIG_FPGA_HAL=y
CONFIG_FPGA_HAL_MOCK=y
# Free-running epoch instead of QEMU's Goldfish RTC: the wallclock tests
# assert monotonicity and latch coherence, not agreement with host time.
CONFIG_FPGA_HAL_MOCK_GOLDFISH_RTC=n

# Deliberately not the defaults — the system_cfg test proves the parsed
# stream/channel limits really come from the emulated CSRs.
CONFIG_FPGA_HAL_MOCK_TX_STREAMS=4
CONFIG_FPGA_HAL_MOCK_TX_CHANNELS=6
CONFIG_FPGA_HAL_MOCK_RX_STREAMS=3
CONFIG_FPGA_HAL_MOCK_RX_CHANNELS=16

CONFIG_MAIN_STACK_SIZE=4096
CONFIG_ZTEST_STACK_SIZE=4096

# QEMU networking backend: SLIRP (user-mode NAT), not a host TAP device.
# The NET_QEMU_NETWORKING choice has no "none" option, and on this board
# it falls through to NET_QEMU_ETHERNET, which wires QEMU to a host TAP
# named "zeth". On any machine without that interface — every CI runner,
# since the TAP is only set up later for the NMOS step — QEMU exits
# within milliseconds and twister reports the run as "unexpected eof"
# with no further explanation. These suites never bring an interface up;
# they only need the networking types and the address helpers.
CONFIG_NET_QEMU_USER=y
```

## src/test_fpga_hal_mock.c
```c
/*
 * Unit tests for the FPGA HAL mock backend
 * (drivers/fpga_hal/fpga_hal_mock.c).
 *
 * Every QEMU-hosted test — including the AMWA NMOS conformance runs —
 * asserts against this emulation, so its own contract needs holding
 * down: register round-trip, the coherent wallclock snapshot protocol
 * and the status word the control plane keys its state machines off.
 */

#include <zephyr/ztest.h>
#include <errno.h>
#include <string.h>

#include "fpga_hal.h"
#include "eth_litex/eth_litex.h"

/* A scratch address the emulation does not special-case. */
#define SCRATCH_ADDR CSR_AES67_CSR_SCRATCH_ADDR

ZTEST(fpga_hal_mock, test_csr_roundtrip)
{
	uint32_t v = 0;

	zassert_equal(fpga_hal_csr_write(SCRATCH_ADDR, 0xDEADBEEF), 0);
	zassert_equal(fpga_hal_csr_read(SCRATCH_ADDR, &v), 0);
	zassert_equal(v, 0xDEADBEEF);

	/* Overwriting reuses the slot rather than consuming a new one. */
	zassert_equal(fpga_hal_csr_write(SCRATCH_ADDR, 0), 0);
	zassert_equal(fpga_hal_csr_read(SCRATCH_ADDR, &v), 0);
	zassert_equal(v, 0);

	/* Reads of never-written registers are zero, not garbage. */
	v = 0x5A5A5A5A;
	zassert_equal(fpga_hal_csr_read(SCRATCH_ADDR + 0x400, &v), 0);
	zassert_equal(v, 0);

	zassert_equal(fpga_hal_csr_read(SCRATCH_ADDR, NULL), -EINVAL);
}

ZTEST(fpga_hal_mock, test_wallclock_snapshot_is_coherent)
{
	uint32_t lo, hi, ns, hi2, ns2;

	/* The firmware's read protocol: SECONDS_LO latches the whole
	 * timestamp, HI and NANOSECONDS are then served from that latch,
	 * so re-reading them cannot straddle a second boundary. */
	zassert_equal(fpga_hal_csr_read(
		CSR_AES67_CSR_WALLCLOCK_SECONDS_IN_LO_ADDR, &lo), 0);
	zassert_equal(fpga_hal_csr_read(
		CSR_AES67_CSR_WALLCLOCK_SECONDS_IN_HI_ADDR, &hi), 0);
	zassert_equal(fpga_hal_csr_read(
		CSR_AES67_CSR_WALLCLOCK_NANOSECONDS_IN_ADDR, &ns), 0);

	k_sleep(K_MSEC(50));

	zassert_equal(fpga_hal_csr_read(
		CSR_AES67_CSR_WALLCLOCK_SECONDS_IN_HI_ADDR, &hi2), 0);
	zassert_equal(fpga_hal_csr_read(
		CSR_AES67_CSR_WALLCLOCK_NANOSECONDS_IN_ADDR, &ns2), 0);
	zassert_equal(hi, hi2, "HI must come from the latch, not live time");
	zassert_equal(ns, ns2, "NS must come from the latch, not live time");

	zassert_true(ns < 1000000000u, "nanoseconds out of range: %u", ns);
	/* The CSR is 30 bits wide. */
	zassert_equal(ns & ~0x3FFFFFFFu, 0);
}

ZTEST(fpga_hal_mock, test_wallclock_advances)
{
	uint32_t lo1, ns1, lo2, ns2, hi;
	uint64_t t1, t2;

	zassert_equal(fpga_hal_csr_read(
		CSR_AES67_CSR_WALLCLOCK_SECONDS_IN_LO_ADDR, &lo1), 0);
	zassert_equal(fpga_hal_csr_read(
		CSR_AES67_CSR_WALLCLOCK_NANOSECONDS_IN_ADDR, &ns1), 0);

	k_sleep(K_MSEC(250));

	zassert_equal(fpga_hal_csr_read(
		CSR_AES67_CSR_WALLCLOCK_SECONDS_IN_LO_ADDR, &lo2), 0);
	zassert_equal(fpga_hal_csr_read(
		CSR_AES67_CSR_WALLCLOCK_SECONDS_IN_HI_ADDR, &hi), 0);
	zassert_equal(fpga_hal_csr_read(
		CSR_AES67_CSR_WALLCLOCK_NANOSECONDS_IN_ADDR, &ns2), 0);

	t1 = (uint64_t)lo1 * 1000000000ull + ns1;
	t2 = (uint64_t)lo2 * 1000000000ull + ns2;
	zassert_true(t2 > t1, "wallclock did not advance");
	zassert_true(t2 - t1 >= 200000000ull,
		     "wallclock advanced by only %llu ns over 250 ms",
		     (unsigned long long)(t2 - t1));

	/* Seconds are a 48-bit field: the high word must stay in range. */
	zassert_equal(hi & ~0xFFFFu, 0);
}

ZTEST(fpga_hal_mock, test_status_word)
{
	uint32_t st = fpga_hal_read_status();

	/* The emulated node presents a usable link and a locked wallclock,
	 * which is what main() and fpga_poll gate the bring-up on. */
	zassert_true(st & FPGA_HAL_ETH_LINK_UP);
	zassert_true(st & FPGA_HAL_CLK_WC_CONFIGURED);
	zassert_true(st & FPGA_HAL_CLK_WC_LOCKED);
	zassert_true(st & FPGA_HAL_CLK_PPB_VALID);
	/* No foreign grandmaster exists in the mock, so it is the leader —
	 * this must agree with read_ptp_leader_id() below. */
	zassert_true(st & FPGA_HAL_PTP_IS_LEADER);
	zassert_false(st & FPGA_HAL_CLK_PTP_LEADER_LOST);
	zassert_equal((st >> FPGA_HAL_ETH_SPEED_SHIFT) & 0x3, 1,
		      "expected 100 Mbit/s link speed");
}

ZTEST(fpga_hal_mock, test_no_foreign_leader)
{
	uint8_t id[8];

	memset(id, 0xFF, sizeof(id));
	zassert_false(fpga_hal_read_ptp_leader_id(id));
	for (int i = 0; i < 8; i++) {
		zassert_equal(id[i], 0, "leader id must be cleared");
	}
}

ZTEST(fpga_hal_mock, test_ready_and_recovery)
{
	zassert_true(fpga_hal_is_ready());
	zassert_equal(fpga_hal_wait_ready(0), 0);
	zassert_equal(fpga_hal_wait_ready(1000), 0);
	zassert_is_null(fpga_hal_get_dev());
	/* The mock never resets; registering a callback is a no-op, not a
	 * crash. */
	fpga_hal_register_recover_cb(NULL, NULL);
}

ZTEST(fpga_hal_mock, test_ptp_tuning_roundtrip)
{
	struct fpga_hal_ptp_tuning in = {
		.kp_gain = -3,
		.ki_gain = 7,
		.gain_shift = 10,
		.gain_shift_locked = 16,
		.ki_extra_shift = 2,
		.filter_shift = 4,
		.warmup_samples = 5,
		.lock_threshold_ns = 1000,
		.unlock_threshold_ns = 5000,
		.lock_count_threshold = 8,
		.min_filter_enable = true,
		.min_filter_active_depth = 3,
		.delay_asymmetry_ns = -250,
	};
	struct fpga_hal_ptp_tuning out;

	memset(&out, 0, sizeof(out));
	zassert_equal(fpga_hal_write_ptp_tuning(&in), 0);
	fpga_hal_read_ptp_tuning(&out);

	zassert_equal(out.kp_gain, in.kp_gain);
	zassert_equal(out.ki_gain, in.ki_gain);
	zassert_equal(out.gain_shift, in.gain_shift);
	zassert_equal(out.gain_shift_locked, in.gain_shift_locked);
	zassert_equal(out.lock_threshold_ns, in.lock_threshold_ns);
	zassert_equal(out.unlock_threshold_ns, in.unlock_threshold_ns);
	zassert_equal(out.min_filter_enable, in.min_filter_enable);
	zassert_equal(out.delay_asymmetry_ns, in.delay_asymmetry_ns);
}

ZTEST(fpga_hal_mock, test_measurements_are_neutral)
{
	uint32_t wc, pll;
	uint16_t rx_sig, rx_clip, tx_sig, tx_clip;
	struct fpga_hal_ptp_monitor mon;

	/* Identical edge counters = zero measured PPB error, so the PI
	 * controller in pll_ctrl has nothing to chase in CI. */
	zassert_true(fpga_hal_read_ppb_counts(&wc, &pll));
	zassert_equal(wc, pll);
	zassert_not_equal(wc, 0, "a zero wallclock count would mean no PPB");

	zassert_equal(fpga_hal_read_path_delay(), 0);
	zassert_equal(fpga_hal_read_ptp_offset(), 0);

	fpga_hal_read_metering(&rx_sig, &rx_clip, &tx_sig, &tx_clip);
	zassert_equal(rx_sig, 0);
	zassert_equal(rx_clip, 0);
	zassert_equal(tx_sig, 0);
	zassert_equal(tx_clip, 0);

	memset(&mon, 0xFF, sizeof(mon));
	fpga_hal_read_ptp_monitor(&mon);
	zassert_true(mon.first_lock_achieved);
}

ZTEST(fpga_hal_mock, test_config_writes_are_accepted)
{
	const uint8_t mac[6] = { 0x02, 0xAA, 0xE6, 0x70, 0x00, 0x01 };
	const uint8_t ch[2] = { 0, 1 };
	struct in_addr ip;

	zassert_equal(net_addr_pton(AF_INET, "192.168.1.50", &ip), 0);

	zassert_equal(fpga_hal_write_mac(mac), 0);
	zassert_equal(fpga_hal_write_ip(&ip), 0);
	zassert_equal(fpga_hal_write_ptp_config(0, -3, 0), 0);
	zassert_equal(fpga_hal_write_ptp_gm_quality(128, 128, 248, 0xFE), 0);
	zassert_equal(fpga_hal_write_tx_stream_config(0, &ip, 2, 48, ch, 2,
						      0x1234), 0);
	zassert_equal(fpga_hal_write_rx_stream_config(0, &ip, 5004, ch, 2, 48,
						      48), 0);

	zassert_equal(fpga_hal_ctrl_set_bits(BIT(0)), 0);
	zassert_equal(fpga_hal_ctrl_clear_bits(BIT(0)), 0);
	zassert_equal(fpga_hal_set_adda_nrst(true), 0);
	zassert_equal(fpga_hal_set_resets(FPGA_HAL_RESET_ALL, false), 0);
	zassert_equal(fpga_hal_set_ptp_reset(false), 0);
}

ZTEST_SUITE(fpga_hal_mock, NULL, NULL, NULL, NULL, NULL);
```

## src/test_fpga_regs.c
```c
/*
 * Unit tests for the PPB arithmetic in src/fpga_regs.c.
 *
 * fpga_calculate_ppb() turns the two clock_ppb_meter edge counters into
 * the frequency error the Si5351A PI controller acts on. A sign flip or
 * an overflow here walks the external PLL away from the wallclock.
 */

#include <zephyr/ztest.h>
#include <stdint.h>

#include "fpga_regs.h"

ZTEST(fpga_regs, test_ppb_zero_error)
{
	zassert_equal(fpga_calculate_ppb(0x200000, 0x200000), 0);
	zassert_equal(fpga_calculate_ppb(1, 1), 0);
}

ZTEST(fpga_regs, test_ppb_sign_and_magnitude)
{
	/* The PLL counted more edges than the wallclock: it runs fast, so
	 * the reported error is positive. */
	zassert_true(fpga_calculate_ppb(1000000, 1000001) > 0);
	zassert_true(fpga_calculate_ppb(1000000, 999999) < 0);

	/* 1 extra edge in 1e6 = 1000 ppb, and the result scales linearly. */
	zassert_equal(fpga_calculate_ppb(1000000, 1000001), 1000);
	zassert_equal(fpga_calculate_ppb(1000000, 999999), -1000);
	zassert_equal(fpga_calculate_ppb(1000000, 1000100), 100000);

	/* 1 edge in 2^21 (the meter's usual window). */
	zassert_equal(fpga_calculate_ppb(0x200000, 0x200001), 476);
}

ZTEST(fpga_regs, test_ppb_guards_division_by_zero)
{
	/* No wallclock edges counted: report no error rather than trap. */
	zassert_equal(fpga_calculate_ppb(0, 0), 0);
	zassert_equal(fpga_calculate_ppb(0, 12345), 0);
}

ZTEST(fpga_regs, test_ppb_saturates)
{
	/* A tiny window with a huge difference would overflow int32; the
	 * result must clamp instead of wrapping to the opposite sign. */
	zassert_equal(fpga_calculate_ppb(1, 1000000000), INT32_MAX);
	zassert_equal(fpga_calculate_ppb(1, 0x7FFFFFFF), INT32_MAX);
	zassert_true(fpga_calculate_ppb(2, 0x7FFFFFFF) > 0,
		     "saturation must not flip the sign");

	/* Same, mirrored: the PLL counter far below the wallclock's. */
	zassert_equal(fpga_calculate_ppb(0x7FFFFFFF, 0), -1000000000);
	zassert_true(fpga_calculate_ppb(1, 0) == -1000000000);
}

ZTEST_SUITE(fpga_regs, NULL, NULL, NULL, NULL, NULL);
```

## src/test_fpga_syscfg.c
```c
/*
 * Unit tests for the backend-neutral system_cfg reader
 * (drivers/fpga_hal/fpga_hal_syscfg.c).
 *
 * These CSRs carry the gateware's build-time configuration, and the
 * firmware dispatches on them at boot: hardware vs. software PTP, and
 * the stream/channel counts the NMOS node reports as its resources. A
 * mis-parsed bitfield here silently advertises hardware that isn't
 * there.
 *
 * The mock's counts are set to non-default values in prj.conf, so the
 * expected values below cannot be satisfied by accident.
 */

#include <zephyr/ztest.h>
#include <errno.h>
#include <string.h>

#include "fpga_hal.h"
#include "eth_litex/eth_litex.h"

/* Mirrors the packing in fpga_hal_mock.c / the gateware's syscfg record. */
#define PACK(reg, field, v)                                                   \
	(((uint32_t)(v) &                                                     \
	  ((1UL << CSR_AES67_CSR_SYSTEM_CFG_##reg##_##field##_SIZE) - 1))     \
	 << CSR_AES67_CSR_SYSTEM_CFG_##reg##_##field##_OFFSET)

ZTEST(fpga_syscfg, test_read_reflects_kconfig)
{
	struct fpga_hal_system_cfg cfg;

	memset(&cfg, 0xFF, sizeof(cfg));
	zassert_equal(fpga_hal_read_system_cfg(&cfg), 0);

	zassert_false(cfg.ptp_in_software,
		      "the mock emulates hardware-PTP gateware");
	zassert_false(cfg.static_ptp_config);
	zassert_true(cfg.metering);

	zassert_equal(cfg.tx_max_streams, CONFIG_FPGA_HAL_MOCK_TX_STREAMS);
	zassert_equal(cfg.tx_channels, CONFIG_FPGA_HAL_MOCK_TX_CHANNELS);
	zassert_equal(cfg.rx_max_streams, CONFIG_FPGA_HAL_MOCK_RX_STREAMS);
	zassert_equal(cfg.rx_channels, CONFIG_FPGA_HAL_MOCK_RX_CHANNELS);

	zassert_equal(cfg.rx_buffer_depth, 256);
	zassert_equal(cfg.tx_buffer_depth, 64);
}

ZTEST(fpga_syscfg, test_load_populates_cache)
{
	zassert_equal(fpga_hal_syscfg_load(), 0);
	zassert_true(fpga_hal_syscfg_valid());

	const struct fpga_hal_system_cfg *c = fpga_hal_syscfg();

	zassert_not_null(c);
	zassert_equal(c->tx_max_streams, CONFIG_FPGA_HAL_MOCK_TX_STREAMS);
	zassert_equal(c->rx_channels, CONFIG_FPGA_HAL_MOCK_RX_CHANNELS);
	zassert_equal(fpga_hal_ptp_in_software(), c->ptp_in_software);
}

ZTEST(fpga_syscfg, test_field_decoding_is_independent)
{
	/* Drive the CSRs directly with values that would alias if an
	 * offset or width were wrong (every field distinct, high bits set
	 * in the widest one). */
	struct fpga_hal_system_cfg cfg;
	uint32_t saved_flags, saved_rx, saved_tx;

	zassert_equal(fpga_hal_csr_read(CSR_AES67_CSR_SYSTEM_CFG_FLAGS_ADDR,
					&saved_flags), 0);
	zassert_equal(fpga_hal_csr_read(CSR_AES67_CSR_SYSTEM_CFG_RX_ADDR,
					&saved_rx), 0);
	zassert_equal(fpga_hal_csr_read(CSR_AES67_CSR_SYSTEM_CFG_TX_ADDR,
					&saved_tx), 0);

	zassert_equal(fpga_hal_csr_write(
		CSR_AES67_CSR_SYSTEM_CFG_FLAGS_ADDR,
		PACK(FLAGS, PTP_IN_SOFTWARE, 1) |
		PACK(FLAGS, STATIC_PTP_CONFIG, 1) |
		PACK(FLAGS, METERING, 0)), 0);
	zassert_equal(fpga_hal_csr_write(
		CSR_AES67_CSR_SYSTEM_CFG_RX_ADDR,
		PACK(RX, MAX_STREAMS, 5) | PACK(RX, CHANNELS, 0xA5) |
		PACK(RX, BUFFER_DEPTH, 4096)), 0);
	zassert_equal(fpga_hal_csr_write(
		CSR_AES67_CSR_SYSTEM_CFG_TX_ADDR,
		PACK(TX, MAX_STREAMS, 0xFF) | PACK(TX, CHANNELS, 1) |
		PACK(TX, BUFFER_DEPTH, 0)), 0);

	zassert_equal(fpga_hal_read_system_cfg(&cfg), 0);

	zassert_true(cfg.ptp_in_software);
	zassert_true(cfg.static_ptp_config);
	zassert_false(cfg.metering);
	zassert_equal(cfg.rx_max_streams, 5);
	zassert_equal(cfg.rx_channels, 0xA5);
	zassert_equal(cfg.rx_buffer_depth, 4096);
	zassert_equal(cfg.tx_max_streams, 0xFF);
	zassert_equal(cfg.tx_channels, 1);
	zassert_equal(cfg.tx_buffer_depth, 0);

	/* Restore, and make sure the cache follows a re-load (the value is
	 * per bitstream, so the FPGA-recovery path re-reads it). */
	zassert_equal(fpga_hal_csr_write(CSR_AES67_CSR_SYSTEM_CFG_FLAGS_ADDR,
					 saved_flags), 0);
	zassert_equal(fpga_hal_csr_write(CSR_AES67_CSR_SYSTEM_CFG_RX_ADDR,
					 saved_rx), 0);
	zassert_equal(fpga_hal_csr_write(CSR_AES67_CSR_SYSTEM_CFG_TX_ADDR,
					 saved_tx), 0);
	zassert_equal(fpga_hal_syscfg_load(), 0);
	zassert_false(fpga_hal_ptp_in_software());
	zassert_equal(fpga_hal_syscfg()->rx_max_streams,
		      CONFIG_FPGA_HAL_MOCK_RX_STREAMS);
}

ZTEST_SUITE(fpga_syscfg, NULL, NULL, NULL, NULL, NULL);
```
