## CMakeLists.txt
```
# Unit tests for the firmware's pure parsing / formatting modules.
#
# These modules have no hardware or network dependency of their own —
# they are compiled straight into the test image, so a failure points at
# the parser and not at the surrounding stack.

cmake_minimum_required(VERSION 3.20.0)
include(${CMAKE_CURRENT_SOURCE_DIR}/../sdk_qemu.cmake)
find_package(Zephyr REQUIRED HINTS $ENV{ZEPHYR_BASE})
project(aes67_parsers_test)

set(APP_DIR ${CMAKE_CURRENT_SOURCE_DIR}/../../app)

target_sources(app PRIVATE
  src/test_nmos_json.c
  src/test_json_util.c
  src/test_sdp_utils.c
  src/test_ieee1588.c

  ${APP_DIR}/src/nmos/nmos_json.c
  ${APP_DIR}/src/webapi/json_util.c
  ${APP_DIR}/src/aes67_sdp_utils.c
)

target_include_directories(app PRIVATE
  ${APP_DIR}/src
  ${APP_DIR}/src/nmos
  ${APP_DIR}/src/webapi
)
```

## prj.conf
```kconfig
CONFIG_ZTEST=y

# aes67_sdp_utils uses zsock_inet_ntop()/zsock_inet_pton() and
# webapi_priv.h pulls in the HTTP server headers. No interface is
# brought up — only the address helpers and the type definitions are
# linked.
CONFIG_NETWORKING=y
CONFIG_NET_IPV4=y
CONFIG_NET_IPV6=n
CONFIG_NET_UDP=y
CONFIG_NET_TCP=y
CONFIG_NET_SOCKETS=y
CONFIG_HTTP_SERVER=y
CONFIG_EVENTFD=y

CONFIG_MAIN_STACK_SIZE=4096
CONFIG_ZTEST_STACK_SIZE=4096

# Request bodies are decoded with Zephyr's JSON library.
CONFIG_JSON_LIBRARY=y

# QEMU networking backend: SLIRP (user-mode NAT), not a host TAP device.
# The NET_QEMU_NETWORKING choice has no "none" option, and on this board
# it falls through to NET_QEMU_ETHERNET, which wires QEMU to a host TAP
# named "zeth". On any machine without that interface — every CI runner,
# since the TAP is only set up later for the NMOS step — QEMU exits
# within milliseconds and twister reports the run as "unexpected eof"
# with no further explanation. These suites never bring an interface up;
# they only need the networking types and the address helpers.
CONFIG_NET_QEMU_USER=y
```

## src/test_ieee1588.c
```c
/*
 * Unit tests for the IEEE 1588 helpers (src/ieee1588_utils.h).
 *
 * The clock identity is what the BMC compares nodes by and what the
 * SDP a=ts-refclk line advertises — a wrong EUI-64 expansion silently
 * makes two devices look like the same grandmaster.
 */

#include <zephyr/ztest.h>
#include <string.h>

#include "ieee1588_utils.h"

ZTEST(ieee1588, test_mac_to_clock_identity)
{
	/* IEEE 1588 7.5.2.2.2: MAC[0..2] with the U/L bit toggled,
	 * FF FE inserted, then MAC[3..5]. */
	const uint8_t mac[6] = { 0x02, 0xAA, 0xE6, 0x70, 0x00, 0x01 };
	const uint8_t expect[8] = {
		0x00, 0xAA, 0xE6, 0xFF, 0xFE, 0x70, 0x00, 0x01
	};
	uint8_t id[8];

	mac_to_clock_identity(mac, id);
	zassert_mem_equal(id, expect, sizeof(expect));
}

ZTEST(ieee1588, test_ul_bit_toggles_both_ways)
{
	/* A globally-unique OUI gets the local bit set, and applying the
	 * transform twice returns the original MAC byte. */
	const uint8_t global_mac[6] = { 0x00, 0x1B, 0x21, 0x11, 0x22, 0x33 };
	uint8_t id[8];

	mac_to_clock_identity(global_mac, id);
	zassert_equal(id[0], 0x02);
	zassert_equal(id[3], 0xFF);
	zassert_equal(id[4], 0xFE);

	uint8_t back[6] = { id[0], id[1], id[2], id[5], id[6], id[7] };
	uint8_t id2[8];

	mac_to_clock_identity(back, id2);
	zassert_equal(id2[0], global_mac[0]);
}

ZTEST(ieee1588, test_distinct_macs_stay_distinct)
{
	const uint8_t a[6] = { 0x02, 0xAA, 0xE6, 0x70, 0x00, 0x01 };
	const uint8_t b[6] = { 0x02, 0xAA, 0xE6, 0x70, 0x00, 0x02 };
	uint8_t ida[8], idb[8];

	mac_to_clock_identity(a, ida);
	mac_to_clock_identity(b, idb);
	zassert_true(memcmp(ida, idb, 8) != 0);
}

ZTEST(ieee1588, test_eth_speed_to_text)
{
	zassert_str_equal(eth_speed_to_text(0), "10M");
	zassert_str_equal(eth_speed_to_text(1), "100M");
	zassert_str_equal(eth_speed_to_text(2), "1G");
	zassert_str_equal(eth_speed_to_text(3), "?");
	zassert_str_equal(eth_speed_to_text(255), "?");
}

ZTEST_SUITE(ieee1588, NULL, NULL, NULL, NULL, NULL);
```

## src/test_json_util.c
```c
/*
 * Unit tests for the REST API's JSON writer and its request-body entry
 * point (src/webapi/json_util.c).
 *
 * The writer's contract is that it never emits truncated (invalid)
 * JSON: overflow is sticky and the caller turns it into a 500 instead
 * of shipping a half-written body.
 *
 * Reading goes through Zephyr's JSON library: what is asserted here is
 * the contract the handlers rely on — absent keys are left untouched
 * (PATCH semantics), presence is reported through the bitmap, and
 * anything malformed or out of range is rejected outright.
 */

#include <zephyr/ztest.h>
#include <errno.h>
#include <string.h>

#include "webapi_priv.h"

static char buf[256];
static struct json_out jo;

static const char *built(void)
{
	jo_finish(&jo);
	return buf;
}

ZTEST(json_util, test_flat_object)
{
	jo_init(&jo, buf, sizeof(buf));
	jo_obj_begin(&jo);
	jo_str(&jo, "name", "node");
	jo_int(&jo, "offset", -42);
	jo_uint(&jo, "ssrc", 3000000000u);
	jo_bool(&jo, "locked", true);
	jo_bool(&jo, "muted", false);
	jo_obj_end(&jo);

	zassert_false(jo.overflow);
	zassert_str_equal(built(),
			  "{\"name\":\"node\",\"offset\":-42,"
			  "\"ssrc\":3000000000,\"locked\":true,"
			  "\"muted\":false}");
}

ZTEST(json_util, test_nested_containers)
{
	jo_init(&jo, buf, sizeof(buf));
	jo_obj_begin(&jo);
	jo_key(&jo, "streams");
	jo_arr_begin(&jo);
	for (int i = 0; i < 2; i++) {
		jo_obj_begin(&jo);
		jo_int(&jo, "id", i);
		jo_obj_end(&jo);
	}
	jo_arr_end(&jo);
	jo_key(&jo, "empty");
	jo_arr_begin(&jo);
	jo_arr_end(&jo);
	jo_obj_end(&jo);

	zassert_false(jo.overflow);
	zassert_str_equal(built(),
			  "{\"streams\":[{\"id\":0},{\"id\":1}],\"empty\":[]}");
}

ZTEST(json_util, test_string_escaping)
{
	jo_init(&jo, buf, sizeof(buf));
	jo_obj_begin(&jo);
	jo_str(&jo, "s", "a\"b\\c\nd\re\tf");
	jo_obj_end(&jo);

	zassert_false(jo.overflow);
	zassert_str_equal(built(),
			  "{\"s\":\"a\\\"b\\\\c\\nd\\re\\tf\"}");

	/* Other control characters go out as \u00XX so the body stays
	 * valid JSON even when a card reports a garbage name. */
	char raw[] = { 'x', 0x01, 0x1f, '\0' };

	jo_init(&jo, buf, sizeof(buf));
	jo_obj_begin(&jo);
	jo_str(&jo, "s", raw);
	jo_obj_end(&jo);
	zassert_str_equal(built(), "{\"s\":\"x\\u0001\\u001f\"}");
}

ZTEST(json_util, test_overflow_is_sticky)
{
	char small[16];

	jo_init(&jo, small, sizeof(small));
	jo_obj_begin(&jo);
	jo_str(&jo, "key", "a value far too long for this buffer");
	zassert_true(jo.overflow);

	size_t pos_at_overflow = jo.pos;

	/* Anything written after the overflow is dropped, and what is in
	 * the buffer is still a NUL-terminated C string. */
	jo_int(&jo, "more", 1);
	jo_obj_end(&jo);
	zassert_true(jo.overflow);
	zassert_equal(jo.pos, pos_at_overflow);
	zassert_true(strlen(small) < sizeof(small));

	/* A zero-sized buffer overflows immediately instead of writing. */
	jo_init(&jo, small, 0);
	zassert_true(jo.overflow);
	jo_obj_begin(&jo);
	zassert_equal(jo.pos, 0);
}

/* ================================================================
 * Request body parsing (Zephyr JSON library via webapi_parse_body)
 * ================================================================ */

struct probe {
	char     name[16];
	int32_t  port;
	uint8_t  channels;
	int8_t   trim;
	bool     enabled;
	uint8_t  ch_ids[8];
	size_t   ch_ids_len;
};

enum { P_NAME, P_PORT, P_CHANNELS, P_TRIM, P_ENABLED, P_CH_IDS };

static const struct json_obj_descr probe_descr[] = {
	[P_NAME] = JSON_OBJ_DESCR_PRIM(struct probe, name,
				       JSON_TOK_STRING_BUF),
	[P_PORT] = JSON_OBJ_DESCR_PRIM(struct probe, port, JSON_TOK_NUMBER),
	[P_CHANNELS] = JSON_OBJ_DESCR_PRIM(struct probe, channels,
					   JSON_TOK_UINT),
	[P_TRIM] = JSON_OBJ_DESCR_PRIM(struct probe, trim, JSON_TOK_INT),
	[P_ENABLED] = JSON_OBJ_DESCR_PRIM(struct probe, enabled,
					  JSON_TOK_TRUE),
	[P_CH_IDS] = JSON_OBJ_DESCR_ARRAY(struct probe, ch_ids, 8, ch_ids_len,
					  JSON_TOK_UINT),
};

/* The parser terminates tokens in place, so bodies must be writable. */
static int64_t parse(char *body, struct probe *out)
{
	struct webapi_request req = {
		.body = body,
		.body_len = strlen(body),
	};

	return webapi_parse_body(&req, probe_descr, ARRAY_SIZE(probe_descr),
				 out);
}

ZTEST(json_util, test_body_decodes_every_type)
{
	char body[] = "{\"name\":\"studio-1\",\"port\":5004,"
		      "\"channels\":8,\"trim\":-12,\"enabled\":true,"
		      "\"ch_ids\":[0,1,2,3]}";
	struct probe p = { 0 };
	int64_t present = parse(body, &p);

	zassert_true(present > 0, "parse failed: %d", (int)present);
	zassert_str_equal(p.name, "studio-1");
	zassert_equal(p.port, 5004);
	zassert_equal(p.channels, 8);
	zassert_equal(p.trim, -12);
	zassert_true(p.enabled);
	zassert_equal(p.ch_ids_len, 4);
	for (int i = 0; i < 4; i++) {
		zassert_equal(p.ch_ids[i], i);
	}

	/* Every descriptor reports present. */
	for (int i = 0; i <= P_CH_IDS; i++) {
		zassert_true(WEBAPI_HAS(present, i), "field %d not reported",
			     i);
	}
}

ZTEST(json_util, test_absent_keys_are_left_alone)
{
	/* PATCH semantics: pre-fill, parse, and everything the body does
	 * not mention keeps the value it had. */
	char body[] = "{\"port\":9000}";
	struct probe p = {
		.port = 5004,
		.channels = 2,
		.trim = 3,
		.enabled = true,
		.ch_ids_len = 2,
	};

	strcpy(p.name, "keep-me");

	int64_t present = parse(body, &p);

	zassert_true(present > 0);
	zassert_equal(p.port, 9000);
	zassert_str_equal(p.name, "keep-me");
	zassert_equal(p.channels, 2);
	zassert_equal(p.trim, 3);
	zassert_true(p.enabled);
	zassert_equal(p.ch_ids_len, 2);

	zassert_true(WEBAPI_HAS(present, P_PORT));
	zassert_false(WEBAPI_HAS(present, P_NAME));
	zassert_false(WEBAPI_HAS(present, P_ENABLED));
}

ZTEST(json_util, test_whitespace_and_unknown_keys)
{
	/* The old substring matcher missed a value behind a space after
	 * the colon, and could match a key nested in another object. */
	char spaced[] = "{ \"name\" : \"spaced\" , \"port\" : 42 }";
	char nested[] = "{\"other\":{\"port\":1},\"port\":7}";
	struct probe p = { 0 };

	zassert_true(parse(spaced, &p) > 0);
	zassert_str_equal(p.name, "spaced");
	zassert_equal(p.port, 42);

	memset(&p, 0, sizeof(p));
	zassert_true(parse(nested, &p) > 0);
	zassert_equal(p.port, 7, "a nested key must not be picked up");
}

ZTEST(json_util, test_escapes_are_decoded)
{
	char body[] = "{\"name\":\"a\\\"b\\\\c\"}";
	struct probe p = { 0 };

	zassert_true(parse(body, &p) > 0);
	zassert_str_equal(p.name, "a\"b\\c");
}

ZTEST(json_util, test_malformed_bodies_are_rejected)
{
	static const char *const bad[] = {
		"{",
		"{\"port\":}",
		"{\"port\" 5004}",
		"not json",
	};
	struct probe p = { 0 };

	ARRAY_FOR_EACH(bad, i) {
		char body[64];

		strncpy(body, bad[i], sizeof(body) - 1);
		body[sizeof(body) - 1] = '\0';
		zassert_true(parse(body, &p) < 0,
			     "\"%s\" should not parse", bad[i]);
	}

	/* Anything after the closing brace is ignored rather than
	 * rejected — the object itself is what the endpoint contracts on,
	 * and an HTTP body never carries a second document. */
	char trailing[] = "{\"port\":5004} and then some";

	zassert_true(parse(trailing, &p) > 0);
	zassert_equal(p.port, 5004);

	/* Out-of-range for the destination type is rejected, not wrapped. */
	char overflow[] = "{\"channels\":300}";

	zassert_true(parse(overflow, &p) < 0);

	/* An empty body is reported as such rather than parsed. */
	char empty[] = "";

	zassert_equal(parse(empty, &p), -EINVAL);
}

ZTEST(json_util, test_oversized_values_are_rejected)
{
	/* name[] is 16 bytes; a longer value must fail rather than being
	 * silently truncated into the fixed field. */
	char body[] = "{\"name\":\"0123456789012345678\"}";
	struct probe p = { 0 };

	zassert_true(parse(body, &p) < 0);

	/* More array elements than the destination holds. */
	char too_many[] = "{\"ch_ids\":[0,1,2,3,4,5,6,7,8,9]}";

	zassert_true(parse(too_many, &p) < 0);
}

ZTEST_SUITE(json_util, NULL, NULL, NULL, NULL, NULL);
```

## src/test_nmos_json.c
```c
/*
 * Unit tests for the minimal JSON DOM parser behind the NMOS
 * Connection API (src/nmos/nmos_json.c).
 *
 * The IS-05/IS-08 PATCH bodies come straight off the wire, so the
 * malformed-input paths matter as much as the happy path.
 */

#include <zephyr/ztest.h>
#include <errno.h>
#include <stdint.h>
#include <string.h>

#include "nmos_json.h"

#define POOL_SIZE 64

static struct nj_node pool[POOL_SIZE];

static const struct nj_node *parse_ok(const char *json)
{
	int root = nj_parse(json, strlen(json), pool, POOL_SIZE);

	zassert_true(root >= 0, "parse failed (%d) for: %s", root, json);
	return &pool[root];
}

ZTEST(nmos_json, test_scalars)
{
	const struct nj_node *root = parse_ok(
		"{\"s\":\"text\",\"i\":42,\"neg\":-7,\"t\":true,"
		"\"f\":false,\"n\":null}");

	zassert_equal(root->type, NJ_OBJ);
	zassert_equal(nj_count(pool, root), 6);

	const struct nj_node *s = nj_get(pool, root, "s");

	zassert_not_null(s);
	zassert_equal(s->type, NJ_STR);
	zassert_true(nj_streq(s, "text"));
	zassert_false(nj_streq(s, "other"));

	zassert_equal(nj_get(pool, root, "i")->num, 42);
	zassert_equal(nj_get(pool, root, "neg")->num, -7);

	zassert_equal(nj_get(pool, root, "t")->type, NJ_BOOL);
	zassert_true(nj_get(pool, root, "t")->bval);
	zassert_false(nj_get(pool, root, "f")->bval);
	zassert_equal(nj_get(pool, root, "n")->type, NJ_NULL);

	/* Absent key, and lookups on non-objects. */
	zassert_is_null(nj_get(pool, root, "missing"));
	zassert_is_null(nj_get(pool, s, "s"));
	zassert_is_null(nj_get(pool, NULL, "s"));
}

ZTEST(nmos_json, test_nested)
{
	/* Shaped like an IS-05 sender PATCH. */
	const struct nj_node *root = parse_ok(
		"{\"transport_params\":["
		"{\"destination_ip\":\"239.69.0.1\",\"destination_port\":5004},"
		"{\"destination_ip\":\"auto\",\"destination_port\":\"auto\"}],"
		"\"activation\":{\"mode\":\"activate_immediate\"}}");

	const struct nj_node *tp = nj_get(pool, root, "transport_params");

	zassert_not_null(tp);
	zassert_equal(tp->type, NJ_ARR);
	zassert_equal(nj_count(pool, tp), 2);

	const struct nj_node *leg0 = nj_item(pool, tp, 0);
	const struct nj_node *leg1 = nj_item(pool, tp, 1);

	zassert_not_null(leg0);
	zassert_true(nj_streq(nj_get(pool, leg0, "destination_ip"),
			      "239.69.0.1"));
	zassert_equal(nj_get(pool, leg0, "destination_port")->num, 5004);
	zassert_true(nj_streq(nj_get(pool, leg1, "destination_port"), "auto"));

	/* Out-of-range index. */
	zassert_is_null(nj_item(pool, tp, 2));
	zassert_is_null(nj_item(pool, tp, -1));

	const struct nj_node *act = nj_get(pool, root, "activation");

	zassert_true(nj_streq(nj_get(pool, act, "mode"), "activate_immediate"));

	/* nj_item() is array-only by contract: an object's members are not
	 * reachable by index, only by key. */
	zassert_is_null(nj_item(pool, act, 0));
	zassert_is_null(nj_item(pool, NULL, 0));
}

ZTEST(nmos_json, test_empty_containers)
{
	const struct nj_node *root = parse_ok("{\"a\":[],\"o\":{}}");

	const struct nj_node *a = nj_get(pool, root, "a");
	const struct nj_node *o = nj_get(pool, root, "o");

	zassert_equal(a->type, NJ_ARR);
	zassert_equal(o->type, NJ_OBJ);
	zassert_equal(nj_count(pool, a), 0);
	zassert_equal(nj_count(pool, o), 0);
	zassert_equal(a->first_child, -1);
	zassert_is_null(nj_item(pool, a, 0));

	/* nj_count() on scalars and NULL is defined as 0. */
	zassert_equal(nj_count(pool, NULL), 0);
	zassert_equal(nj_count(pool, parse_ok("7")), 0);
}

ZTEST(nmos_json, test_top_level_scalar_and_whitespace)
{
	const struct nj_node *n = parse_ok("  \r\n\t 42 \r\n ");

	zassert_equal(n->type, NJ_NUM);
	zassert_equal(n->num, 42);

	n = parse_ok("\t{ \"a\" : [ 1 , 2 ] }\n");
	zassert_equal(nj_count(pool, nj_get(pool, n, "a")), 2);
}

ZTEST(nmos_json, test_number_edges)
{
	/* Non-integer numbers are accepted syntactically, integer part kept. */
	zassert_equal(parse_ok("1.75")->num, 1);
	zassert_equal(parse_ok("-2.5")->num, -2);
	zassert_equal(parse_ok("1e3")->num, 1);

	/* Values beyond int32 saturate rather than wrap. */
	zassert_equal(parse_ok("99999999999")->num, INT32_MAX);
	zassert_equal(parse_ok("0")->num, 0);
}

ZTEST(nmos_json, test_strcpy_unescapes)
{
	const struct nj_node *root = parse_ok(
		"{\"a\":\"line\\nnext\\ttab\","
		"\"b\":\"quote\\\"slash\\\\fwd\\/\","
		"\"c\":\"\\u0041\\u007a\","
		"\"d\":\"\\u1234\"}");
	char out[32];

	zassert_equal(nj_strcpy(nj_get(pool, root, "a"), out, sizeof(out)), 13);
	zassert_mem_equal(out, "line\nnext\ttab", 14);

	zassert_true(nj_strcpy(nj_get(pool, root, "b"), out, sizeof(out)) > 0);
	zassert_str_equal(out, "quote\"slash\\fwd/");

	/* Basic-Latin \u escapes are mapped, anything else becomes '?'. */
	zassert_equal(nj_strcpy(nj_get(pool, root, "c"), out, sizeof(out)), 2);
	zassert_str_equal(out, "Az");
	zassert_equal(nj_strcpy(nj_get(pool, root, "d"), out, sizeof(out)), 1);
	zassert_str_equal(out, "?");
}

ZTEST(nmos_json, test_strcpy_errors)
{
	const struct nj_node *root = parse_ok("{\"s\":\"abcdef\",\"i\":1}");
	char out[4];

	/* Too small for value + NUL. */
	zassert_equal(nj_strcpy(nj_get(pool, root, "s"), out, sizeof(out)),
		      -ENOMEM);
	/* Not a string / no node / zero-size buffer. */
	zassert_equal(nj_strcpy(nj_get(pool, root, "i"), out, sizeof(out)),
		      -EINVAL);
	zassert_equal(nj_strcpy(NULL, out, sizeof(out)), -EINVAL);
	zassert_equal(nj_strcpy(nj_get(pool, root, "s"), out, 0), -EINVAL);

	/* nj_streq() never matches a non-string node. */
	zassert_false(nj_streq(nj_get(pool, root, "i"), "1"));
	zassert_false(nj_streq(NULL, ""));
}

ZTEST(nmos_json, test_malformed_input)
{
	static const char *const bad[] = {
		"",                       /* empty */
		"{",                      /* unterminated object */
		"[1,2",                   /* unterminated array */
		"{\"a\":}",               /* missing value */
		"{\"a\" 1}",              /* missing colon */
		"{a:1}",                  /* unquoted key */
		"{\"a\":1,}",             /* trailing comma */
		"{\"a\":\"unterminated}", /* unterminated string */
		"tru",                    /* truncated literal */
		"nul",
		"{\"a\":1} trailing",     /* garbage after the root value */
		"[1,2][3]",
		"-",                      /* sign without digits */
		"@",                      /* not a JSON value at all */
	};

	ARRAY_FOR_EACH(bad, i) {
		int ret = nj_parse(bad[i], strlen(bad[i]), pool, POOL_SIZE);

		zassert_equal(ret, -EINVAL, "expected -EINVAL for \"%s\", got %d",
			      bad[i], ret);
	}
}

ZTEST(nmos_json, test_pool_exhaustion)
{
	const char *json = "[1,2,3,4,5,6,7,8]";
	struct nj_node small[4];

	zassert_equal(nj_parse(json, strlen(json), small, ARRAY_SIZE(small)),
		      -ENOMEM);

	/* The same body fits in a pool sized for array + elements. */
	struct nj_node exact[9];

	zassert_true(nj_parse(json, strlen(json), exact, ARRAY_SIZE(exact)) >= 0);
}

ZTEST(nmos_json, test_depth_limit)
{
	/* Guard against stack exhaustion from hostile nesting. */
	const char *deep = "[[[[[[[[[[[[1]]]]]]]]]]]]";

	zassert_equal(nj_parse(deep, strlen(deep), pool, POOL_SIZE), -EINVAL);

	/* Nesting the API actually uses stays well inside the limit. */
	const char *ok = "{\"a\":{\"b\":[{\"c\":1}]}}";

	zassert_true(nj_parse(ok, strlen(ok), pool, POOL_SIZE) >= 0);
}

ZTEST_SUITE(nmos_json, NULL, NULL, NULL, NULL, NULL);
```

## src/test_sdp_utils.c
```c
/*
 * Unit tests for the shared SDP builder/parser (src/aes67_sdp_utils.c).
 *
 * The generated body is what SAP announcements, RTSP DESCRIBE and the
 * NMOS sender manifests all ship, so the canonical case is asserted
 * verbatim — a silent change here breaks interop, not just a unit test.
 */

#include <zephyr/ztest.h>
#include <zephyr/net/net_ip.h>
#include <errno.h>
#include <string.h>

#include "aes67_sdp_utils.h"

static const uint8_t clock_id[8] = {
	0x02, 0xAA, 0xE6, 0x70, 0x00, 0x01, 0x02, 0x03
};

static struct in_addr addr(const char *s)
{
	struct in_addr a;

	zassert_equal(net_addr_pton(AF_INET, s, &a), 0, "bad address %s", s);
	return a;
}

static struct aes67_sdp_params default_params(void)
{
	struct aes67_sdp_params p = {
		.origin_addr        = addr("192.168.1.50"),
		.connection_addr    = addr("239.69.0.1"),
		.stream_id          = 0,
		.channel_count      = 2,
		.bit_depth          = 24,
		.sample_rate        = 48000,
		.samples_per_packet = 48,
		.port               = 5004,
		.payload_type       = 97,
		.ssrc               = 0x12345678,
		.clock_id           = clock_id,
		.stream_name        = "Test Stream",
		.ptp_domain         = 0,
		.sync_time          = 0,
	};

	return p;
}

/* 192.168.1.50 as a host-order integer — the session id the builder
 * derives from the origin address plus the stream index. */
#define SESSION_ID "3232235826"

static const char canonical_sdp[] =
	"v=0\r\n"
	"o=- " SESSION_ID " 0 IN IP4 192.168.1.50\r\n"
	"s=Test Stream\r\n"
	"i=2ch 24bit 48000Hz\r\n"
	"t=0 0\r\n"
	"a=clock-domain:PTPv2 0\r\n"
	"m=audio 5004 RTP/AVP 97\r\n"
	"c=IN IP4 239.69.0.1/32\r\n"
	"a=source-filter: incl IN IP4 239.69.0.1 192.168.1.50\r\n"
	"a=rtpmap:97 L24/48000/2\r\n"
	"a=ptime:1.000\r\n"
	"a=sync-time:0\r\n"
	"a=ts-refclk:ptp=IEEE1588-2008:02-AA-E6-70-00-01-02-03:0\r\n"
	"a=mediaclk:direct=0\r\n"
	"a=ssrc:305419896 cname:aes67@192.168.1.50\r\n";

ZTEST(sdp_utils, test_build_canonical)
{
	struct aes67_sdp_params p = default_params();
	char buf[1024];
	int n = aes67_sdp_build(buf, sizeof(buf), &p);

	zassert_equal(n, (int)strlen(canonical_sdp), "length mismatch");
	zassert_str_equal(buf, canonical_sdp);
}

ZTEST(sdp_utils, test_build_optional_lines)
{
	struct aes67_sdp_params p = default_params();
	char buf[1024];

	/* No grandmaster known: ts-refclk must be omitted rather than
	 * claiming traceability to an all-zero clock. */
	p.clock_id = NULL;
	zassert_true(aes67_sdp_build(buf, sizeof(buf), &p) > 0);
	zassert_is_null(strstr(buf, "ts-refclk"));

	/* SSRC 0 means "not assigned yet" -> no a=ssrc line. */
	p = default_params();
	p.ssrc = 0;
	zassert_true(aes67_sdp_build(buf, sizeof(buf), &p) > 0);
	zassert_is_null(strstr(buf, "a=ssrc:"));

	/* source-filter is a multicast-only (SSM) attribute. */
	p = default_params();
	p.connection_addr = addr("192.168.1.99");
	zassert_true(aes67_sdp_build(buf, sizeof(buf), &p) > 0);
	zassert_is_null(strstr(buf, "source-filter"));
	zassert_not_null(strstr(buf, "c=IN IP4 192.168.1.99/32\r\n"));

	/* ...and it needs a known origin to name as the source. */
	p = default_params();
	memset(&p.origin_addr, 0, sizeof(p.origin_addr));
	zassert_true(aes67_sdp_build(buf, sizeof(buf), &p) > 0);
	zassert_is_null(strstr(buf, "source-filter"));

	/* Empty / NULL stream name falls back to the generic session name. */
	p = default_params();
	p.stream_name = NULL;
	zassert_true(aes67_sdp_build(buf, sizeof(buf), &p) > 0);
	zassert_not_null(strstr(buf, "s=AES67 Stream\r\n"));
	p.stream_name = "";
	zassert_true(aes67_sdp_build(buf, sizeof(buf), &p) > 0);
	zassert_not_null(strstr(buf, "s=AES67 Stream\r\n"));
}

ZTEST(sdp_utils, test_build_ptime_and_domain)
{
	struct aes67_sdp_params p = default_params();
	char buf[1024];

	/* 12 samples @ 48 kHz = 250 us -> "0.250". */
	p.samples_per_packet = 12;
	p.ptp_domain = 127;
	p.sync_time = 4242;
	zassert_true(aes67_sdp_build(buf, sizeof(buf), &p) > 0);
	zassert_not_null(strstr(buf, "a=ptime:0.250\r\n"));
	zassert_not_null(strstr(buf, "a=clock-domain:PTPv2 127\r\n"));
	zassert_not_null(strstr(buf, "a=sync-time:4242\r\n"));
	zassert_not_null(strstr(buf,
		"a=ts-refclk:ptp=IEEE1588-2008:02-AA-E6-70-00-01-02-03:127\r\n"));

	/* 96 kHz / 96 samples = 1 ms again, and the rtpmap follows the rate. */
	p = default_params();
	p.sample_rate = 96000;
	p.samples_per_packet = 96;
	p.channel_count = 8;
	zassert_true(aes67_sdp_build(buf, sizeof(buf), &p) > 0);
	zassert_not_null(strstr(buf, "a=rtpmap:97 L24/96000/8\r\n"));
	zassert_not_null(strstr(buf, "a=ptime:1.000\r\n"));
}

ZTEST(sdp_utils, test_build_truncation_is_bounded)
{
	struct aes67_sdp_params p = default_params();
	/* Guard bytes on both sides: snprintf() returns the length it WOULD
	 * have written, so an unguarded builder walks off the end after the
	 * first truncated line. */
	struct {
		uint8_t front[16];
		char body[48];
		uint8_t back[16];
	} g;

	memset(&g, 0xA5, sizeof(g));

	for (size_t sz = 1; sz <= sizeof(g.body); sz++) {
		int n = aes67_sdp_build(g.body, sz, &p);

		zassert_equal(n, -ENOMEM,
			      "buffer of %zu bytes should not fit an SDP body",
			      sz);
		for (size_t i = 0; i < sizeof(g.front); i++) {
			zassert_equal(g.front[i], 0xA5, "underrun at %zu", i);
			zassert_equal(g.back[i], 0xA5, "overrun at %zu", i);
		}
	}
}

ZTEST(sdp_utils, test_parse_roundtrip)
{
	struct aes67_sdp_parsed out;

	zassert_equal(aes67_sdp_parse(canonical_sdp, strlen(canonical_sdp),
				      &out), 0);

	zassert_str_equal(out.name, "Test Stream");
	/* "o=-" is the anonymous origin: no user name to report. */
	zassert_str_equal(out.origin_name, "");
	zassert_equal(out.origin_addr.s_addr, addr("192.168.1.50").s_addr);
	zassert_equal(out.connection_addr.s_addr, addr("239.69.0.1").s_addr);
	zassert_equal(out.port, 5004);
	zassert_equal(out.channels, 2);
	zassert_equal(out.bit_depth, 24);
	zassert_equal(out.sample_rate, 48000);
	zassert_equal(out.ssrc, 0x12345678);
	/* a=ptime:1.000 @ 48 kHz -> 48 samples per packet. */
	zassert_equal(out.samples_per_packet, 48);
	zassert_true(out.has_clock_domain);
	zassert_equal(out.ptp_domain, 0);
	zassert_true(out.has_sync_time);
	zassert_equal(out.sync_time, 0);
}

ZTEST(sdp_utils, test_parse_foreign_variants)
{
	struct aes67_sdp_parsed out;
	/* A RAVENNA-style announcement: named origin, LF-only line ends,
	 * session-level c=, fractional ptime, non-zero domain. */
	static const char sdp[] =
		"v=0\n"
		"o=ravenna 1234 1 IN IP4 10.0.0.7\n"
		"s=Horus Out 1\n"
		"c=IN IP4 239.1.2.3/32\n"
		"t=0 0\n"
		"a=clock-domain:PTPv2 42\n"
		"m=audio 5004 RTP/AVP 98\n"
		"a=rtpmap:98 L16/44100/1\n"
		"a=ptime:0.125\n"
		"a=sync-time:987654\n"
		"a=ssrc:42 cname:x@y\n";

	zassert_equal(aes67_sdp_parse(sdp, strlen(sdp), &out), 0);
	zassert_str_equal(out.name, "Horus Out 1");
	zassert_str_equal(out.origin_name, "ravenna");
	zassert_equal(out.origin_addr.s_addr, addr("10.0.0.7").s_addr);
	zassert_equal(out.connection_addr.s_addr, addr("239.1.2.3").s_addr);
	zassert_equal(out.port, 5004);
	zassert_equal(out.channels, 1);
	zassert_equal(out.bit_depth, 16);
	zassert_equal(out.sample_rate, 44100);
	zassert_equal(out.ssrc, 42);
	zassert_equal(out.ptp_domain, 42);
	zassert_true(out.has_clock_domain);
	zassert_equal(out.sync_time, 987654);
	/* 125 us @ 44.1 kHz = 5.5 -> 5 samples (integer truncation). */
	zassert_equal(out.samples_per_packet, 5);
}

ZTEST(sdp_utils, test_parse_defensive)
{
	struct aes67_sdp_parsed out;

	/* Empty and junk input must not fault; everything stays zeroed. */
	zassert_equal(aes67_sdp_parse("", 0, &out), 0);
	zassert_equal(out.port, 0);
	zassert_equal(out.sample_rate, 0);
	zassert_false(out.has_clock_domain);
	zassert_false(out.has_sync_time);

	static const char junk[] = "not sdp at all\r\nx\r\n=\r\nv\r\n";

	zassert_equal(aes67_sdp_parse(junk, strlen(junk), &out), 0);
	zassert_equal(out.port, 0);

	/* An over-long session name is truncated into the fixed field. */
	static const char long_name[] =
		"s=0123456789012345678901234567890123456789\r\n";

	zassert_equal(aes67_sdp_parse(long_name, strlen(long_name), &out), 0);
	zassert_equal(strlen(out.name), AES67_SDP_NAME_MAX - 1);

	/* ptime without a rtpmap: no sample rate, so no conversion happens
	 * and the raw microseconds are left in place. */
	static const char ptime_only[] = "a=ptime:1.000\r\n";

	zassert_equal(aes67_sdp_parse(ptime_only, strlen(ptime_only), &out), 0);
	zassert_equal(out.sample_rate, 0);
	zassert_equal(out.samples_per_packet, 1000);

	/* Non-PTPv2 clock-domain is ignored rather than mis-parsed. */
	static const char other_clock[] = "a=clock-domain:PTPv1 3\r\n";

	zassert_equal(aes67_sdp_parse(other_clock, strlen(other_clock), &out),
		      0);
	zassert_false(out.has_clock_domain);
}

ZTEST(sdp_utils, test_format_clock_id)
{
	char buf[32];

	zassert_equal(aes67_format_clock_id(buf, sizeof(buf), clock_id), 23);
	zassert_str_equal(buf, "02-AA-E6-70-00-01-02-03");
}

ZTEST(sdp_utils, test_ptime_us)
{
	zassert_equal(aes67_ptime_us(48, 48000), 1000);
	zassert_equal(aes67_ptime_us(6, 48000), 125);
	zassert_equal(aes67_ptime_us(96, 96000), 1000);
	zassert_equal(aes67_ptime_us(64, 48000), 1333);
}

ZTEST(sdp_utils, test_strncasecmp)
{
	zassert_equal(aes67_strncasecmp("abc", "ABC", 3), 0);
	zassert_equal(aes67_strncasecmp("abc", "abc", 100), 0,
		      "must stop at the NUL, not read past it");
	zassert_equal(aes67_strncasecmp("abcdef", "abcXYZ", 3), 0);
	zassert_true(aes67_strncasecmp("abc", "abd", 3) < 0);
	zassert_true(aes67_strncasecmp("abd", "abc", 3) > 0);
	zassert_equal(aes67_strncasecmp("anything", "else", 0), 0);
	zassert_true(aes67_strncasecmp("ab", "abc", 3) < 0);
}

ZTEST(sdp_utils, test_parse_uint)
{
	uint32_t v;
	const char *s = "1234abc";
	const char *p = aes67_parse_uint(s, s + strlen(s), &v);

	zassert_equal(v, 1234);
	zassert_equal(p, s + 4, "must stop at the first non-digit");

	/* No digits at all: zero, and the cursor does not move. */
	s = "abc";
	p = aes67_parse_uint(s, s + 3, &v);
	zassert_equal(v, 0);
	zassert_equal(p, s);

	/* The end pointer is honoured even mid-number. */
	s = "9999";
	p = aes67_parse_uint(s, s + 2, &v);
	zassert_equal(v, 99);
	zassert_equal(p, s + 2);
}

ZTEST_SUITE(sdp_utils, NULL, NULL, NULL, NULL, NULL);
```
