## soc_firmware/tests/aes70/testcase.yaml
```yaml
common:
  tags:
    - aes67
    - unit
  platform_allow:
    - qemu_riscv64
  integration_platforms:
    - qemu_riscv64
tests:
  aes67.unit.aes70:
    timeout: 60
```

## soc_firmware/tests/fpga_hal/testcase.yaml
```yaml
common:
  tags:
    - aes67
    - unit
  platform_allow:
    - qemu_riscv64
  integration_platforms:
    - qemu_riscv64
tests:
  aes67.unit.fpga_hal:
    timeout: 60
```

## soc_firmware/tests/parsers/testcase.yaml
```yaml
common:
  tags:
    - aes67
    - unit
  platform_allow:
    - qemu_riscv64
  integration_platforms:
    - qemu_riscv64
tests:
  aes67.unit.parsers:
    timeout: 60
```
