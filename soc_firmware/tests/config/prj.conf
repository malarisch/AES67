## CMakeLists.txt
```
# Unit tests for the device configuration and its JSON persistence
# format, and for the connection-management stream tables underneath.
#
# aes67_conn writes through the FPGA HAL, so the mock backend is linked
# in — the same one the QEMU firmware image uses. No interface is
# brought up: the IGMP proxy joins are skipped while iface is NULL.

cmake_minimum_required(VERSION 3.20.0)
include(${CMAKE_CURRENT_SOURCE_DIR}/../sdk_qemu.cmake)
find_package(Zephyr REQUIRED HINTS $ENV{ZEPHYR_BASE})
project(aes67_config_test)

set(APP_DIR ${CMAKE_CURRENT_SOURCE_DIR}/../../app)

# fpga_hal (mock + syscfg) — brings its own include paths for the
# generated aes67_bridge CSR headers.
add_subdirectory(${APP_DIR}/drivers ${CMAKE_CURRENT_BINARY_DIR}/app_drivers)

target_sources(app PRIVATE
  src/test_aes67_config.c
  src/test_config_json.c
  src/test_aes67_conn.c

  ${APP_DIR}/src/aes67_config.c
  ${APP_DIR}/src/config_json.c
  ${APP_DIR}/src/aes67_conn.c
  ${APP_DIR}/src/card_manager.c
  ${APP_DIR}/src/card_settings.c
  ${APP_DIR}/drivers/auracast_card/auracast_card_proto.c
)

target_include_directories(app PRIVATE ${APP_DIR}/src ${APP_DIR}/drivers/auracast_card)
```

## Kconfig
```
# Reuse the application's driver Kconfig so the FPGA HAL mock backend
# (and its FPGA_HAL_MOCK_* stream/channel counts) is configurable here
# exactly as it is in the firmware build.
rsource "../../app/drivers/Kconfig"

source "Kconfig.zephyr"
```

## prj.conf
```kconfig
CONFIG_ZTEST=y

# aes67_conn / config_json use net_if, IGMP and the socket address
# helpers. No interface is started; the tests drive the tables directly.
CONFIG_NETWORKING=y
CONFIG_NET_IPV4=y
CONFIG_NET_IPV6=n
CONFIG_NET_UDP=y
CONFIG_NET_SOCKETS=y
CONFIG_NET_IPV4_IGMP=y
CONFIG_NET_IF_MCAST_IPV4_ADDR_COUNT=16

# Same register-map emulation the QEMU firmware image runs against.
CONFIG_FPGA_HAL=y
CONFIG_FPGA_HAL_MOCK=y
CONFIG_FPGA_HAL_MOCK_GOLDFISH_RTC=n

CONFIG_MAIN_STACK_SIZE=8192
CONFIG_ZTEST_STACK_SIZE=8192
CONFIG_LOG=y
CONFIG_LOG_MODE_IMMEDIATE=y

# Zephyr JSON library: config persistence and the REST request bodies
# are described as descriptor tables (config_json.c, webapi/).
CONFIG_JSON_LIBRARY=y

# QEMU networking backend: SLIRP (user-mode NAT), not a host TAP device.
# The NET_QEMU_NETWORKING choice has no "none" option, and on this board
# it falls through to NET_QEMU_ETHERNET, which wires QEMU to a host TAP
# named "zeth". On any machine without that interface — every CI runner,
# since the TAP is only set up later for the NMOS step — QEMU exits
# within milliseconds and twister reports the run as "unexpected eof"
# with no further explanation. These suites never bring an interface up;
# they only need the networking types and the address helpers.
CONFIG_NET_QEMU_USER=y
```

## src/test_aes67_config.c
```c
/*
 * Unit tests for the global device configuration (src/aes67_config.c).
 *
 * The derived identities matter beyond this module: the MAC is what the
 * Ethernet driver programs into the FPGA, and the hostname is what mDNS,
 * RTSP and the NMOS node advertise. All three must be stable functions
 * of the stored serial / device name.
 */

#include <zephyr/ztest.h>
#include <string.h>

#include "aes67_config.h"

static void reset_config(void *fixture)
{
	ARG_UNUSED(fixture);
	(void)aes67_config_get();     /* first call installs the defaults */
	aes67_config_reset_defaults();
}

ZTEST(aes67_config, test_defaults)
{
	const struct aes67_device_config *c = aes67_config_get();

	zassert_str_equal(c->vendor, "AES67");
	zassert_str_equal(c->product, "AudioNode");
	zassert_str_equal(c->serial, "0001");
	zassert_str_equal(c->device_name, "AES67 Node");

	zassert_str_equal(c->default_mcast_addr, "239.69.0.1");
	zassert_equal(c->default_port, 5004);
	zassert_equal(c->default_channels, 2);
	zassert_equal(c->default_bit_depth, 24);
	zassert_equal(c->default_sample_rate, 48000);
	zassert_equal(c->default_samples_per_pkt, 48);
	zassert_equal(c->default_payload_type, 97);

	/* AES67 media profile: sync every 125 ms, announce every 1 s. */
	zassert_equal(c->ptp_domain, 0);
	zassert_equal(c->ptp_priority1, 128);
	zassert_equal(c->ptp_priority2, 128);
	zassert_equal(c->ptp_clock_class, 248);
	zassert_equal(c->ptp_clock_accuracy, 0xFE);
	zassert_equal(c->ptp_log_sync_interval, -3);
	zassert_equal(c->ptp_log_announce_interval, 0);
	zassert_equal(c->ptp_delay_asymmetry_ns, 0);

	zassert_equal(c->pi_kp_num, 1);
	zassert_equal(c->pi_kp_den, 4);
	zassert_equal(c->pi_ki_num, 1);
	zassert_equal(c->pi_ki_den, 32);

	zassert_equal(c->sap_announce_interval_s, 30);
	zassert_true(c->sap_announce_enabled);
}

ZTEST(aes67_config, test_reset_clears_previous_values)
{
	struct aes67_device_config *c = aes67_config_get();

	strcpy(c->device_name, "Changed");
	c->default_port = 1234;
	c->sap_announce_enabled = false;

	aes67_config_reset_defaults();

	zassert_str_equal(c->device_name, "AES67 Node");
	zassert_equal(c->default_port, 5004);
	zassert_true(c->sap_announce_enabled);
}

ZTEST(aes67_config, test_node_id)
{
	char buf[AES67_NODE_ID_MAX];

	zassert_equal_ptr(aes67_config_build_node_id(buf, sizeof(buf)), buf);
	zassert_str_equal(buf, "AES67 AudioNode 0001");

	struct aes67_device_config *c = aes67_config_get();

	strcpy(c->vendor, "Acme");
	strcpy(c->product, "Mixer");
	strcpy(c->serial, "4711");
	aes67_config_build_node_id(buf, sizeof(buf));
	zassert_str_equal(buf, "Acme Mixer 4711");

	/* A zero-length buffer must not be written to. */
	char guard = '#';

	zassert_equal_ptr(aes67_config_build_node_id(&guard, 0), &guard);
	zassert_equal(guard, '#');
	zassert_is_null(aes67_config_build_node_id(NULL, 16));
}

ZTEST(aes67_config, test_hostname_from_device_name)
{
	char buf[AES67_NODE_ID_MAX];

	/* Friendly name wins: spaces dropped, lowercased for DNS. */
	aes67_config_build_hostname(buf, sizeof(buf));
	zassert_str_equal(buf, "aes67node");

	struct aes67_device_config *c = aes67_config_get();

	strcpy(c->device_name, "Studio B Rack 2");
	aes67_config_build_hostname(buf, sizeof(buf));
	zassert_str_equal(buf, "studiobrack2");

	/* No friendly name: fall back to vendor_product_serial. */
	c->device_name[0] = '\0';
	aes67_config_build_hostname(buf, sizeof(buf));
	zassert_str_equal(buf, "aes67_audionode_0001");
}

ZTEST(aes67_config, test_hostname_is_bounded)
{
	struct aes67_device_config *c = aes67_config_get();
	char small[8];

	strcpy(c->device_name, "AVeryLongDeviceName");
	memset(small, 0x5A, sizeof(small));
	aes67_config_build_hostname(small, sizeof(small));
	zassert_equal(strlen(small), sizeof(small) - 1);
	zassert_str_equal(small, "averylo");
}

ZTEST(aes67_config, test_mac_from_numeric_serial)
{
	struct aes67_device_config *c = aes67_config_get();
	uint8_t mac[6];

	/* The historic default serial keeps its historic MAC. */
	aes67_config_build_mac(mac);
	zassert_mem_equal(mac, "\x02\xAA\xE6\x70\x00\x01", 6);

	strcpy(c->serial, "65535");
	aes67_config_build_mac(mac);
	zassert_mem_equal(mac, "\x02\xAA\xE6\x70\xFF\xFF", 6);

	strcpy(c->serial, "258");
	aes67_config_build_mac(mac);
	zassert_mem_equal(mac, "\x02\xAA\xE6\x70\x01\x02", 6);
}

ZTEST(aes67_config, test_mac_from_hashed_serial)
{
	struct aes67_device_config *c = aes67_config_get();
	uint8_t a[6], b[6], again[6];

	/* Out of the 16-bit range, non-numeric and empty serials are all
	 * folded — still locally administered, still deterministic. */
	static const char *const hashed[] = { "65536", "SN-ABC-123", "0001x",
					      "" };

	ARRAY_FOR_EACH(hashed, i) {
		strcpy(c->serial, hashed[i]);
		aes67_config_build_mac(a);
		aes67_config_build_mac(again);
		zassert_mem_equal(a, again, 6, "serial \"%s\" is not stable",
				  hashed[i]);
		zassert_mem_equal(a, "\x02\xAA\xE6\x70", 4,
				  "locally-administered prefix lost");
	}

	strcpy(c->serial, "SN-ABC-123");
	aes67_config_build_mac(a);
	strcpy(c->serial, "SN-ABC-124");
	aes67_config_build_mac(b);
	zassert_true(memcmp(a, b, 6) != 0,
		     "different serials must not collide");
}

ZTEST_SUITE(aes67_config, NULL, NULL, reset_config, NULL, NULL);
```

## src/test_aes67_conn.c
```c
/*
 * Unit tests for connection management (src/aes67_conn.c): the TX/RX
 * stream tables, their validation, the change observers and the
 * foreign-stream registry fed by SAP / mDNS / RTSP.
 *
 * The FPGA writes go to the mock HAL backend, so what is asserted here
 * is the table state every consumer (web API, NMOS, persistence,
 * announcers) reads back.
 */

#include <zephyr/ztest.h>
#include <zephyr/net/net_ip.h>
#include <errno.h>
#include <string.h>

#include "aes67_conn.h"

static struct in_addr addr(const char *s)
{
	struct in_addr a;

	zassert_equal(net_addr_pton(AF_INET, s, &a), 0, "bad address %s", s);
	return a;
}

static const struct in_addr zero_addr;

/* ---- Observer bookkeeping (registered once; no unregister API) ---- */

static int tx_notify_count;
static int rx_notify_count;
static uint8_t tx_last_id = 0xFF;
static uint8_t rx_last_id = 0xFF;

static void tx_observer(uint8_t stream_id)
{
	tx_notify_count++;
	tx_last_id = stream_id;
}

static void rx_observer(uint8_t stream_id)
{
	rx_notify_count++;
	rx_last_id = stream_id;
}

static void *conn_setup(void)
{
	zassert_equal(aes67_conn_register_tx_observer(tx_observer), 0);
	zassert_equal(aes67_conn_register_rx_observer(rx_observer), 0);
	return NULL;
}

/* Every test starts from empty tables — the module keeps global state
 * for the whole image. */
static void clear_all(void *fixture)
{
	static const uint8_t ch[AES67_MAX_CH_PER_STREAM] = { 0 };

	ARG_UNUSED(fixture);

	for (uint8_t i = 0; i < AES67_MAX_TX_STREAMS; i++) {
		zassert_equal(aes67_conn_configure_tx_stream(
				      i, &zero_addr, 0, 48, ch, 0, 0, NULL), 0);
	}
	for (uint8_t i = 0; i < AES67_MAX_RX_STREAMS; i++) {
		zassert_equal(aes67_conn_configure_rx_stream(
				      i, &zero_addr, 0, ch, 1, 0, 48, NULL,
				      NULL, NULL), 0);
	}

	int count;
	const struct aes67_foreign_stream *fs =
		aes67_conn_get_foreign_streams(&count);

	for (int i = 0; i < AES67_MAX_FOREIGN_STREAMS; i++) {
		if (fs[i].valid) {
			struct aes67_foreign_stream del = {
				.valid = false,
				.id_hash = fs[i].id_hash,
			};

			aes67_conn_report_foreign_stream(&del);
		}
	}

	tx_notify_count = 0;
	rx_notify_count = 0;
	tx_last_id = 0xFF;
	rx_last_id = 0xFF;
}

/* ================================================================
 * TX streams
 * ================================================================ */

ZTEST(aes67_conn, test_tx_configure)
{
	const uint8_t ch_ids[4] = { 3, 2, 1, 0 };
	struct in_addr dst = addr("239.69.0.5");

	zassert_equal(aes67_conn_configure_tx_stream(2, &dst, 4, 48, ch_ids, 4,
						     0xCAFEBABE, "Mic Bus"), 0);

	const struct aes67_tx_stream *tx = aes67_conn_get_tx_streams();

	zassert_true(tx[2].active);
	zassert_equal(tx[2].stream_id, 2);
	zassert_str_equal(tx[2].name, "Mic Bus");
	zassert_equal(tx[2].dst_ip.s_addr, dst.s_addr);
	zassert_equal(tx[2].channel_count, 4);
	zassert_equal(tx[2].samples_per_packet, 48);
	zassert_equal(tx[2].ssrc, 0xCAFEBABE);
	zassert_mem_equal(tx[2].ch_ids, ch_ids, 4);
	/* Unused channel slots are cleared, not left over from a previous
	 * configuration. */
	for (int i = 4; i < AES67_MAX_CH_PER_STREAM; i++) {
		zassert_equal(tx[2].ch_ids[i], 0);
	}

	/* Only the addressed slot is touched. */
	zassert_false(tx[0].active);
	zassert_false(tx[7].active);
}

ZTEST(aes67_conn, test_tx_auto_name_and_ssrc)
{
	const uint8_t ch_ids[2] = { 0, 1 };
	struct in_addr dst = addr("239.69.0.1");

	/* NULL name -> generated; SSRC 0 -> derived from dst IP + slot. */
	zassert_equal(aes67_conn_configure_tx_stream(3, &dst, 2, 48, ch_ids, 2,
						     0, NULL), 0);

	const struct aes67_tx_stream *tx = aes67_conn_get_tx_streams();

	zassert_str_equal(tx[3].name, "TX Stream 3");
	zassert_not_equal(tx[3].ssrc, 0);

	/* Deterministic for the same slot + destination... */
	uint32_t ssrc3 = tx[3].ssrc;

	zassert_equal(aes67_conn_configure_tx_stream(3, &dst, 2, 48, ch_ids, 2,
						     0, ""), 0);
	zassert_equal(tx[3].ssrc, ssrc3);
	zassert_str_equal(tx[3].name, "TX Stream 3",
			  "an empty name must also auto-generate");

	/* ...and different for a different slot. */
	zassert_equal(aes67_conn_configure_tx_stream(4, &dst, 2, 48, ch_ids, 2,
						     0, NULL), 0);
	zassert_not_equal(tx[4].ssrc, ssrc3);
}

ZTEST(aes67_conn, test_tx_deactivate)
{
	const uint8_t ch_ids[2] = { 0, 1 };
	struct in_addr dst = addr("239.69.0.9");

	zassert_equal(aes67_conn_configure_tx_stream(1, &dst, 2, 48, ch_ids, 2,
						     0, NULL), 0);
	zassert_true(aes67_conn_get_tx_streams()[1].active);

	/* A zero destination deactivates... */
	zassert_equal(aes67_conn_configure_tx_stream(1, &zero_addr, 2, 48,
						     ch_ids, 2, 0, NULL), 0);
	zassert_false(aes67_conn_get_tx_streams()[1].active);

	/* ...and so does a zero channel count. */
	zassert_equal(aes67_conn_configure_tx_stream(1, &dst, 2, 48, ch_ids, 2,
						     0, NULL), 0);
	zassert_true(aes67_conn_get_tx_streams()[1].active);
	zassert_equal(aes67_conn_configure_tx_stream(1, &dst, 0, 48, ch_ids, 0,
						     0, NULL), 0);
	zassert_false(aes67_conn_get_tx_streams()[1].active);
}

ZTEST(aes67_conn, test_tx_rejects_bad_arguments)
{
	const uint8_t ch_ids[2] = { 0, 1 };
	struct in_addr dst = addr("239.69.0.1");

	zassert_equal(aes67_conn_configure_tx_stream(AES67_MAX_TX_STREAMS, &dst,
						     2, 48, ch_ids, 2, 0, NULL),
		      -EINVAL);
	zassert_equal(aes67_conn_configure_tx_stream(255, &dst, 2, 48, ch_ids,
						     2, 0, NULL), -EINVAL);
	zassert_equal(aes67_conn_configure_tx_stream(0, NULL, 2, 48, ch_ids, 2,
						     0, NULL), -EINVAL);
	zassert_equal(aes67_conn_configure_tx_stream(0, &dst, 2, 48, NULL, 2, 0,
						     NULL), -EINVAL);
}

ZTEST(aes67_conn, test_tx_channel_list_is_bounded)
{
	/* More channel IDs than the stream can carry: the surplus must be
	 * dropped, not written past the fixed-size table entry. */
	const uint8_t ch_ids[16] = { 0, 1, 2, 3, 4, 5, 6, 7,
				     8, 9, 10, 11, 12, 13, 14, 15 };
	struct in_addr dst = addr("239.69.0.1");

	zassert_equal(aes67_conn_configure_tx_stream(0, &dst, 8, 48, ch_ids,
						     ARRAY_SIZE(ch_ids), 0,
						     NULL), 0);

	const struct aes67_tx_stream *tx = aes67_conn_get_tx_streams();

	zassert_mem_equal(tx[0].ch_ids, ch_ids, AES67_MAX_CH_PER_STREAM);
	/* The next table entry must still be untouched. */
	zassert_false(tx[1].active);
}

ZTEST(aes67_conn, test_tx_copy_under_lock)
{
	const uint8_t ch_ids[2] = { 6, 7 };
	struct in_addr dst = addr("239.69.0.3");
	struct aes67_tx_stream out;

	memset(&out, 0xAA, sizeof(out));

	/* Inactive slot: nothing copied, false returned. */
	zassert_false(aes67_conn_copy_tx_stream(5, &out));

	zassert_equal(aes67_conn_configure_tx_stream(5, &dst, 2, 12, ch_ids, 2,
						     0x11223344, "Copy"), 0);
	zassert_true(aes67_conn_copy_tx_stream(5, &out));
	zassert_str_equal(out.name, "Copy");
	zassert_equal(out.ssrc, 0x11223344);
	zassert_equal(out.samples_per_packet, 12);

	zassert_false(aes67_conn_copy_tx_stream(AES67_MAX_TX_STREAMS, &out));
	zassert_false(aes67_conn_copy_tx_stream(0, NULL));
}

/* ================================================================
 * RX streams
 * ================================================================ */

ZTEST(aes67_conn, test_rx_configure)
{
	const uint8_t ch_map[2] = { 4, 5 };
	struct in_addr dst = addr("239.69.1.1");
	struct in_addr sender = addr("10.0.0.7");

	zassert_equal(aes67_conn_configure_rx_stream(1, &dst, 5004, ch_map, 2,
						     16, 48, "Remote Mix",
						     "Horus", &sender), 0);

	const struct aes67_rx_stream *rx = aes67_conn_get_rx_streams();

	zassert_true(rx[1].active);
	zassert_equal(rx[1].stream_id, 1);
	zassert_str_equal(rx[1].name, "Remote Mix");
	zassert_str_equal(rx[1].sender_name, "Horus");
	zassert_equal(rx[1].sender_ip.s_addr, sender.s_addr);
	zassert_equal(rx[1].dst_ip.s_addr, dst.s_addr);
	zassert_equal(rx[1].dst_port, 5004);
	zassert_equal(rx[1].channel_count, 2);
	zassert_equal(rx[1].samples_per_channel, 48);
	/* The table keeps the raw playout delay; only the gateware register
	 * carries the +2*spp offset. */
	zassert_equal(rx[1].output_delay, 16);
	zassert_mem_equal(rx[1].ch_map, ch_map, 2);
}

ZTEST(aes67_conn, test_rx_auto_name_and_deactivate)
{
	const uint8_t ch_map[2] = { 0, 1 };
	struct in_addr dst = addr("239.69.1.2");

	zassert_equal(aes67_conn_configure_rx_stream(2, &dst, 5004, ch_map, 2,
						     0, 48, NULL, NULL, NULL),
		      0);

	const struct aes67_rx_stream *rx = aes67_conn_get_rx_streams();

	zassert_str_equal(rx[2].name, "RX Stream 2");
	zassert_str_equal(rx[2].sender_name, "");
	zassert_equal(rx[2].sender_ip.s_addr, 0);

	/* Deactivating clears the identity so a stale sender name can't
	 * survive into the next subscription. */
	zassert_equal(aes67_conn_configure_rx_stream(2, &zero_addr, 0, ch_map,
						     2, 0, 48, "x", "y", &dst),
		      0);
	zassert_false(rx[2].active);
	zassert_str_equal(rx[2].name, "");
	zassert_str_equal(rx[2].sender_name, "");
	zassert_equal(rx[2].sender_ip.s_addr, 0);
}

ZTEST(aes67_conn, test_rx_delay_clamp_is_accepted)
{
	const uint8_t ch_map[1] = { 0 };
	struct in_addr dst = addr("239.69.1.3");

	/* delay + 2*spp overflows the 8-bit gateware field; the call must
	 * still succeed (clamped in hardware) and keep the raw values. */
	zassert_equal(aes67_conn_configure_rx_stream(0, &dst, 5004, ch_map, 1,
						     200, 96, NULL, NULL, NULL),
		      0);

	const struct aes67_rx_stream *rx = aes67_conn_get_rx_streams();

	zassert_true(rx[0].active);
	zassert_equal(rx[0].output_delay, 200);
	zassert_equal(rx[0].samples_per_channel, 96);
}

ZTEST(aes67_conn, test_rx_rejects_bad_arguments)
{
	const uint8_t ch_map[2] = { 0, 1 };
	struct in_addr dst = addr("239.69.1.1");

	zassert_equal(aes67_conn_configure_rx_stream(AES67_MAX_RX_STREAMS, &dst,
						     5004, ch_map, 2, 0, 48,
						     NULL, NULL, NULL),
		      -EINVAL);
	zassert_equal(aes67_conn_configure_rx_stream(0, NULL, 5004, ch_map, 2,
						     0, 48, NULL, NULL, NULL),
		      -EINVAL);
	zassert_equal(aes67_conn_configure_rx_stream(0, &dst, 5004, NULL, 2, 0,
						     48, NULL, NULL, NULL),
		      -EINVAL);
	/* Channel count must be 1..AES67_MAX_CH_PER_STREAM. */
	zassert_equal(aes67_conn_configure_rx_stream(0, &dst, 5004, ch_map, 0,
						     0, 48, NULL, NULL, NULL),
		      -EINVAL);
	zassert_equal(aes67_conn_configure_rx_stream(0, &dst, 5004, ch_map,
						     AES67_MAX_CH_PER_STREAM + 1,
						     0, 48, NULL, NULL, NULL),
		      -EINVAL);
}

/* ================================================================
 * Observers
 * ================================================================ */

ZTEST(aes67_conn, test_observers_are_notified)
{
	const uint8_t ch[2] = { 0, 1 };
	struct in_addr dst = addr("239.69.2.1");

	zassert_equal(tx_notify_count, 0);
	zassert_equal(aes67_conn_configure_tx_stream(6, &dst, 2, 48, ch, 2, 0,
						     NULL), 0);
	zassert_equal(tx_notify_count, 1);
	zassert_equal(tx_last_id, 6);

	/* Deactivation is a change too — announcers must withdraw. */
	zassert_equal(aes67_conn_configure_tx_stream(6, &zero_addr, 0, 48, ch,
						     0, 0, NULL), 0);
	zassert_equal(tx_notify_count, 2);

	/* A rejected call must not fire the observer. */
	zassert_equal(aes67_conn_configure_tx_stream(99, &dst, 2, 48, ch, 2, 0,
						     NULL), -EINVAL);
	zassert_equal(tx_notify_count, 2);

	zassert_equal(rx_notify_count, 0);
	zassert_equal(aes67_conn_configure_rx_stream(6, &dst, 5004, ch, 2, 0,
						     48, NULL, NULL, NULL), 0);
	zassert_equal(rx_notify_count, 1);
	zassert_equal(rx_last_id, 6);

	zassert_equal(aes67_conn_configure_rx_stream(99, &dst, 5004, ch, 2, 0,
						     48, NULL, NULL, NULL),
		      -EINVAL);
	zassert_equal(rx_notify_count, 1);
}

/* ================================================================
 * Foreign-stream registry
 * ================================================================ */

static struct aes67_foreign_stream make_foreign(uint16_t hash,
						const char *origin,
						const char *name)
{
	struct aes67_foreign_stream fs = {
		.valid = true,
		.via = AES67_VIA_SAP,
		.id_hash = hash,
		.origin_addr = addr(origin),
		.mcast_addr = addr("239.69.9.1"),
		.port = 5004,
		.channels = 2,
		.bit_depth = 24,
		.sample_rate = 48000,
	};

	strncpy(fs.name, name, sizeof(fs.name) - 1);
	return fs;
}

static const struct aes67_foreign_stream *find_foreign(uint16_t hash)
{
	int count;
	const struct aes67_foreign_stream *fs =
		aes67_conn_get_foreign_streams(&count);

	for (int i = 0; i < AES67_MAX_FOREIGN_STREAMS; i++) {
		if (fs[i].valid && fs[i].id_hash == hash) {
			return &fs[i];
		}
	}
	return NULL;
}

ZTEST(aes67_conn, test_foreign_upsert_and_delete)
{
	struct aes67_foreign_stream a = make_foreign(0x1234, "10.0.0.1",
						     "Sender A");
	int count;

	aes67_conn_get_foreign_streams(&count);
	zassert_equal(count, 0);

	aes67_conn_report_foreign_stream(&a);
	aes67_conn_get_foreign_streams(&count);
	zassert_equal(count, 1);
	zassert_str_equal(find_foreign(0x1234)->name, "Sender A");

	/* Same hash + same origin updates in place rather than duplicating. */
	strcpy(a.name, "Sender A renamed");
	a.channels = 8;
	aes67_conn_report_foreign_stream(&a);
	aes67_conn_get_foreign_streams(&count);
	zassert_equal(count, 1);
	zassert_str_equal(find_foreign(0x1234)->name, "Sender A renamed");
	zassert_equal(find_foreign(0x1234)->channels, 8);

	/* Same hash from a different origin is a genuinely different
	 * sighting and gets its own slot. */
	struct aes67_foreign_stream b = make_foreign(0x1234, "10.0.0.2",
						     "Sender B");

	aes67_conn_report_foreign_stream(&b);
	aes67_conn_get_foreign_streams(&count);
	zassert_equal(count, 2);

	/* valid = false deletes every entry with that hash. */
	struct aes67_foreign_stream del = { .valid = false, .id_hash = 0x1234 };

	aes67_conn_report_foreign_stream(&del);
	aes67_conn_get_foreign_streams(&count);
	zassert_equal(count, 0);

	/* Deleting an unknown hash and reporting NULL are both harmless. */
	aes67_conn_report_foreign_stream(&del);
	aes67_conn_report_foreign_stream(NULL);
	aes67_conn_get_foreign_streams(&count);
	zassert_equal(count, 0);
}

ZTEST(aes67_conn, test_foreign_touch_refreshes)
{
	struct aes67_foreign_stream a = make_foreign(0x55, "10.0.0.1", "S");

	aes67_conn_report_foreign_stream(&a);

	int64_t first = find_foreign(0x55)->last_seen_ms;

	k_sleep(K_MSEC(20));
	aes67_conn_touch_foreign_stream(0x55);
	zassert_true(find_foreign(0x55)->last_seen_ms > first,
		     "touch must refresh the expiry timestamp");

	/* Touching an unknown hash must not disturb the table. */
	aes67_conn_touch_foreign_stream(0xBEEF);

	int count;

	aes67_conn_get_foreign_streams(&count);
	zassert_equal(count, 1);
}

ZTEST(aes67_conn, test_foreign_table_full)
{
	int count;

	for (int i = 0; i < AES67_MAX_FOREIGN_STREAMS; i++) {
		struct aes67_foreign_stream fs =
			make_foreign((uint16_t)(0x100 + i), "10.0.0.1", "S");

		aes67_conn_report_foreign_stream(&fs);
	}
	aes67_conn_get_foreign_streams(&count);
	zassert_equal(count, AES67_MAX_FOREIGN_STREAMS);

	/* One more sighting is dropped, and must not corrupt the table. */
	struct aes67_foreign_stream extra = make_foreign(0xFFFF, "10.0.0.1",
							 "Overflow");

	aes67_conn_report_foreign_stream(&extra);
	aes67_conn_get_foreign_streams(&count);
	zassert_equal(count, AES67_MAX_FOREIGN_STREAMS);
	zassert_is_null(find_foreign(0xFFFF));
	zassert_not_null(find_foreign(0x100));

	/* Freeing a slot lets the next sighting in. */
	struct aes67_foreign_stream del = { .valid = false, .id_hash = 0x100 };

	aes67_conn_report_foreign_stream(&del);
	aes67_conn_report_foreign_stream(&extra);
	aes67_conn_get_foreign_streams(&count);
	zassert_equal(count, AES67_MAX_FOREIGN_STREAMS);
	zassert_not_null(find_foreign(0xFFFF));
}

ZTEST_SUITE(aes67_conn, NULL, conn_setup, clear_all, NULL, NULL);
```

## src/test_config_json.c
```c
/*
 * Unit tests for the persisted configuration format
 * (src/config_json.c) — the exact bytes written to SD card and SPI
 * flash, and read back at every boot.
 *
 * A round trip that loses a field silently reverts the device to
 * defaults after a power cycle, so the roundtrip test compares the
 * whole configuration and both stream tables.
 */

#include <zephyr/ztest.h>
#include <zephyr/net/net_ip.h>
#include <errno.h>
#include <string.h>

#include "aes67_config.h"
#include "aes67_conn.h"
#include "config_json.h"
#include "card_manager.h"
#include "card_settings.h"

#define JSON_BUF 8192

static char json[JSON_BUF];

static struct in_addr addr(const char *s)
{
	struct in_addr a;

	zassert_equal(net_addr_pton(AF_INET, s, &a), 0, "bad address %s", s);
	return a;
}

static const struct in_addr zero_addr;

static void clear_streams(void)
{
	static const uint8_t ch[AES67_MAX_CH_PER_STREAM] = { 0 };

	for (uint8_t i = 0; i < AES67_MAX_TX_STREAMS; i++) {
		(void)aes67_conn_configure_tx_stream(i, &zero_addr, 0, 48, ch,
						     0, 0, NULL);
	}
	for (uint8_t i = 0; i < AES67_MAX_RX_STREAMS; i++) {
		(void)aes67_conn_configure_rx_stream(i, &zero_addr, 0, ch, 1, 0,
						     48, NULL, NULL, NULL);
	}
}

static void reset_all(void *fixture)
{
	ARG_UNUSED(fixture);
	(void)aes67_config_get();
	aes67_config_reset_defaults();
	clear_streams();
	memset(json, 0, sizeof(json));
}

ZTEST(config_json, test_serialize_defaults_is_wellformed)
{
	int len = config_json_serialize(json, sizeof(json));

	zassert_true(len > 0 && len < (int)sizeof(json),
		     "serialize returned %d", len);
	zassert_equal((size_t)len, strlen(json));
	zassert_equal(json[0], '{');
	zassert_equal(json[len - 1], '}');

	/* No dangling comma before a closing brace/bracket. */
	for (int i = 0; i + 2 < len; i++) {
		if (json[i] != ',') {
			continue;
		}
		int j = i + 1;

		while (j < len && (json[j] == ' ' || json[j] == '\n' ||
				   json[j] == '\t' || json[j] == '\r')) {
			j++;
		}
		zassert_true(json[j] != '}' && json[j] != ']',
			     "trailing comma at offset %d", i);
	}

	/* Empty stream tables still emit their (empty) arrays. */
	zassert_not_null(strstr(json, "\"tx_streams\""));
	zassert_not_null(strstr(json, "\"rx_streams\""));
	zassert_not_null(strstr(json, "\"vendor\":\"AES67\""));
}

ZTEST(config_json, test_roundtrip_device_config)
{
	struct aes67_device_config *c = aes67_config_get();

	strcpy(c->vendor, "Acme");
	strcpy(c->product, "StageBox");
	strcpy(c->serial, "SN-42");
	strcpy(c->device_name, "Studio B");
	strcpy(c->default_mcast_addr, "239.70.1.2");
	c->default_port = 5006;
	c->default_channels = 8;
	c->default_bit_depth = 16;
	c->default_sample_rate = 96000;
	c->default_samples_per_pkt = 96;
	c->default_payload_type = 98;
	c->ptp_domain = 7;
	c->ptp_priority1 = 100;
	c->ptp_priority2 = 110;
	c->ptp_log_sync_interval = -4;
	c->ptp_log_announce_interval = 1;
	c->ptp_delay_asymmetry_ns = -1234;
	c->pi_kp_num = 3;
	c->pi_kp_den = 8;
	c->pi_ki_num = 5;
	c->pi_ki_den = 64;
	c->pi_imax = 400000;
	c->pi_outlier_ppb = 12345678;
	c->pi_warmup_cycles = 9;
	c->sap_announce_interval_s = 15;
	c->sap_announce_enabled = false;

	struct aes67_device_config saved = *c;
	int len = config_json_serialize(json, sizeof(json));

	zassert_true(len > 0 && len < (int)sizeof(json));

	aes67_config_reset_defaults();
	zassert_str_equal(c->vendor, "AES67", "precondition: defaults restored");

	zassert_equal(config_json_parse_and_apply(json), 0);

	zassert_str_equal(c->vendor, saved.vendor);
	zassert_str_equal(c->product, saved.product);
	zassert_str_equal(c->serial, saved.serial);
	zassert_str_equal(c->device_name, saved.device_name);
	zassert_str_equal(c->default_mcast_addr, saved.default_mcast_addr);
	zassert_equal(c->default_port, saved.default_port);
	zassert_equal(c->default_channels, saved.default_channels);
	zassert_equal(c->default_bit_depth, saved.default_bit_depth);
	zassert_equal(c->default_sample_rate, saved.default_sample_rate);
	zassert_equal(c->default_samples_per_pkt, saved.default_samples_per_pkt);
	zassert_equal(c->default_payload_type, saved.default_payload_type);
	zassert_equal(c->ptp_domain, saved.ptp_domain);
	zassert_equal(c->ptp_priority1, saved.ptp_priority1);
	zassert_equal(c->ptp_priority2, saved.ptp_priority2);
	zassert_equal(c->ptp_log_sync_interval, saved.ptp_log_sync_interval);
	zassert_equal(c->ptp_log_announce_interval,
		      saved.ptp_log_announce_interval);
	zassert_equal(c->ptp_delay_asymmetry_ns, saved.ptp_delay_asymmetry_ns);
	zassert_equal(c->pi_kp_num, saved.pi_kp_num);
	zassert_equal(c->pi_kp_den, saved.pi_kp_den);
	zassert_equal(c->pi_ki_num, saved.pi_ki_num);
	zassert_equal(c->pi_ki_den, saved.pi_ki_den);
	zassert_equal(c->pi_imax, saved.pi_imax);
	zassert_equal(c->pi_outlier_ppb, saved.pi_outlier_ppb);
	zassert_equal(c->pi_warmup_cycles, saved.pi_warmup_cycles);
	zassert_equal(c->sap_announce_interval_s, saved.sap_announce_interval_s);
	zassert_equal(c->sap_announce_enabled, saved.sap_announce_enabled);
}

ZTEST(config_json, test_roundtrip_streams)
{
	const uint8_t tx_ch[4] = { 7, 6, 5, 4 };
	const uint8_t rx_map[2] = { 2, 3 };
	struct in_addr tx_dst = addr("239.69.0.11");
	struct in_addr rx_dst = addr("239.69.1.22");
	struct in_addr sender = addr("10.1.2.3");

	zassert_equal(aes67_conn_configure_tx_stream(0, &tx_dst, 4, 24, tx_ch,
						     4, 0xDEADBEEF, "Front"),
		      0);
	zassert_equal(aes67_conn_configure_tx_stream(3, &tx_dst, 2, 48, tx_ch,
						     2, 0, NULL), 0);
	zassert_equal(aes67_conn_configure_rx_stream(2, &rx_dst, 5008, rx_map,
						     2, 32, 48, "Monitor",
						     "Console", &sender), 0);

	uint32_t tx3_ssrc = aes67_conn_get_tx_streams()[3].ssrc;
	int len = config_json_serialize(json, sizeof(json));

	zassert_true(len > 0 && len < (int)sizeof(json));

	clear_streams();
	zassert_false(aes67_conn_get_tx_streams()[0].active);

	zassert_equal(config_json_parse_and_apply(json), 0);

	const struct aes67_tx_stream *tx = aes67_conn_get_tx_streams();
	const struct aes67_rx_stream *rx = aes67_conn_get_rx_streams();

	zassert_true(tx[0].active);
	zassert_str_equal(tx[0].name, "Front");
	zassert_equal(tx[0].dst_ip.s_addr, tx_dst.s_addr);
	zassert_equal(tx[0].channel_count, 4);
	zassert_equal(tx[0].samples_per_packet, 24);
	zassert_equal(tx[0].ssrc, 0xDEADBEEF);
	zassert_mem_equal(tx[0].ch_ids, tx_ch, 4);

	/* The auto-generated SSRC is persisted, not regenerated. */
	zassert_true(tx[3].active);
	zassert_equal(tx[3].ssrc, tx3_ssrc);

	/* Slots that were inactive at save time stay inactive. */
	zassert_false(tx[1].active);
	zassert_false(tx[7].active);

	zassert_true(rx[2].active);
	zassert_str_equal(rx[2].name, "Monitor");
	zassert_str_equal(rx[2].sender_name, "Console");
	zassert_equal(rx[2].sender_ip.s_addr, sender.s_addr);
	zassert_equal(rx[2].dst_ip.s_addr, rx_dst.s_addr);
	zassert_equal(rx[2].dst_port, 5008);
	zassert_equal(rx[2].channel_count, 2);
	zassert_equal(rx[2].output_delay, 32);
	zassert_equal(rx[2].samples_per_channel, 48);
	zassert_mem_equal(rx[2].ch_map, rx_map, 2);
	zassert_false(rx[0].active);
}

ZTEST(config_json, test_partial_json_keeps_defaults)
{
	/* The parser NUL-terminates tokens in place, so the document has
	 * to live in writable memory — never a string literal. */
	char partial[] =
		"{\n  \"device_name\": \"Only This\",\n"
		"  \"ptp_domain\": 5\n}\n";
	struct aes67_device_config *c = aes67_config_get();

	zassert_equal(config_json_parse_and_apply(partial), 0);

	zassert_str_equal(c->device_name, "Only This");
	zassert_equal(c->ptp_domain, 5);
	/* Everything not mentioned keeps its current value. */
	zassert_str_equal(c->vendor, "AES67");
	zassert_equal(c->default_port, 5004);
	zassert_true(c->sap_announce_enabled);
	/* No stream arrays: the tables are left alone, not wiped. */
	zassert_false(aes67_conn_get_tx_streams()[0].active);
}

ZTEST(config_json, test_whitespace_and_key_order_are_irrelevant)
{
	/* Compact, reordered and unknown keys all have to parse — this is
	 * what a hand-edited or externally generated config looks like. */
	char compact[] =
		"{\"ptp_domain\":9,\"unknown_key\":{\"nested\":[1,2]},"
		"\"device_name\":\"Compact\",\"vendor\":\"X\"}";
	char spaced[] =
		"{ \"ptp_domain\" : 11 , \"device_name\" : \"Spaced\" }";
	struct aes67_device_config *c = aes67_config_get();

	zassert_equal(config_json_parse_and_apply(compact), 0);
	zassert_equal(c->ptp_domain, 9);
	zassert_str_equal(c->device_name, "Compact");
	zassert_str_equal(c->vendor, "X");

	zassert_equal(config_json_parse_and_apply(spaced), 0);
	zassert_equal(c->ptp_domain, 11);
	zassert_str_equal(c->device_name, "Spaced");
}

ZTEST(config_json, test_escaped_strings_roundtrip)
{
	struct aes67_device_config *c = aes67_config_get();

	strcpy(c->device_name, "Studio \"B\"\\Rack");

	int len = config_json_serialize(json, sizeof(json));

	zassert_true(len > 0);
	/* The value must be escaped on the way out... */
	zassert_not_null(strstr(json, "Studio \\\"B\\\"\\\\Rack"));

	aes67_config_reset_defaults();
	zassert_equal(config_json_parse_and_apply(json), 0);
	/* ...and unescaped on the way back in. */
	zassert_str_equal(c->device_name, "Studio \"B\"\\Rack");
}

ZTEST(config_json, test_malformed_json_is_rejected_atomically)
{
	struct aes67_device_config *c = aes67_config_get();
	char empty[] = "";
	char truncated[] = "{";
	char not_json[] = "not json at all";
	char half_stream[] = "{\"tx_streams\": [{\"stream_id\": ";
	/* A value that does not fit its field: rejected rather than
	 * silently truncated to 44 by a cast. */
	char out_of_range[] = "{\"device_name\":\"Bad\",\"default_channels\":300}";

	zassert_true(config_json_parse_and_apply(empty) < 0);
	zassert_true(config_json_parse_and_apply(truncated) < 0);
	zassert_true(config_json_parse_and_apply(not_json) < 0);
	zassert_true(config_json_parse_and_apply(half_stream) < 0);
	zassert_true(config_json_parse_and_apply(out_of_range) < 0);
	zassert_equal(config_json_parse_and_apply(NULL), -EINVAL);

	/* A rejected document applies nothing at all — not even the keys
	 * that appeared before the bad one. The device keeps running on
	 * its current configuration. */
	zassert_str_equal(c->vendor, "AES67");
	zassert_str_equal(c->device_name, "AES67 Node");
	zassert_equal(c->default_port, 5004);
	zassert_equal(c->default_channels, 2);
}

ZTEST(config_json, test_serialize_reports_overflow)
{
	/* Undersized buffers must report an error and leave the
	 * surrounding memory alone — no writing past the end, and no
	 * half-written document handed to the storage backend. */
	static struct {
		uint8_t front[32];
		char body[512];
		uint8_t back[32];
	} g;

	/* Give the serializer something to overflow with. */
	const uint8_t ch[2] = { 0, 1 };
	struct in_addr dst = addr("239.69.0.1");

	zassert_equal(aes67_conn_configure_tx_stream(0, &dst, 2, 48, ch, 2, 0,
						     "Guarded"), 0);

	memset(&g, 0xA5, sizeof(g));

	for (size_t sz = 1; sz <= sizeof(g.body); sz++) {
		int len = config_json_serialize(g.body, sz);

		zassert_true(len < 0,
			     "size %zu: expected an overflow report, got %d",
			     sz, len);
		zassert_equal(g.body[0], '\0',
			      "size %zu: a failed encode must not leave a "
			      "partial document behind", sz);
		for (size_t i = 0; i < sizeof(g.front); i++) {
			zassert_equal(g.front[i], 0xA5,
				      "size %zu: underrun at %zu", sz, i);
			zassert_equal(g.back[i], 0xA5,
				      "size %zu: overrun at %zu", sz, i);
		}
	}

	zassert_equal(config_json_serialize(NULL, 16), -EINVAL);
	zassert_equal(config_json_serialize(g.body, 0), -EINVAL);
}

ZTEST_SUITE(config_json, NULL, NULL, reset_all, NULL, NULL);

/* ---- Auracast card: stream configuration in the card section ---- */

static void store_auracast(const struct auracast_config *aura)
{
	struct card_settings *cs;

	card_settings_lock();
	cs = card_settings_get();
	memset(cs, 0, sizeof(*cs));
	cs->valid = true;
	cs->card_type = CARD_TYPE_AURACAST;
	cs->aura = *aura;
	card_settings_unlock();
}

ZTEST(config_json, test_auracast_settings_roundtrip)
{
	struct auracast_config aura;
	const struct card_settings *cs;
	int len;

	aura_proto_config_defaults(&aura);
	strcpy(aura.name, "Main Hall");
	strcpy(aura.code, "secret");
	aura.preset = AURA_PRESET_48_4_1;
	aura.channels = AURA_CH_STEREO;
	aura.context = 0x0004;
	aura.broadcast_id = 0x123456;
	aura.enabled = false;
	aura.hq_preset = AURA_PRESET_48_6_1;
	aura.hq_channels = AURA_CH_MONO_MIX;
	aura.hq_context = 0x0044;
	store_auracast(&aura);

	/* No card is detected in the test image: capture() returns -ENODEV
	 * and leaves the store alone, exactly as for an unplugged card. */
	len = config_json_serialize(json, sizeof(json));
	zassert_true(len > 0);
	zassert_not_null(strstr(json, "\"card_type\":\"auracast\""));
	zassert_not_null(strstr(json, "\"aura_name\":\"Main Hall\""));

	card_settings_lock();
	memset(card_settings_get(), 0, sizeof(struct card_settings));
	card_settings_unlock();

	zassert_equal(config_json_parse_and_apply(json), 0);

	card_settings_lock();
	cs = card_settings_get();
	zassert_true(cs->valid);
	zassert_equal(cs->card_type, CARD_TYPE_AURACAST);
	zassert_false(cs->aura.enabled);
	zassert_equal(cs->aura.preset, AURA_PRESET_48_4_1);
	zassert_equal(cs->aura.channels, AURA_CH_STEREO);
	zassert_equal(cs->aura.context, 0x0004);
	zassert_equal(cs->aura.flags, aura.flags);
	zassert_equal(cs->aura.tx_power_dbm, aura.tx_power_dbm);
	zassert_equal(cs->aura.pd_us, aura.pd_us);
	zassert_equal(cs->aura.fifo_target, aura.fifo_target);
	zassert_equal(cs->aura.broadcast_id, 0x123456);
	zassert_str_equal(cs->aura.name, "Main Hall");
	zassert_str_equal(cs->aura.code, "secret");
	zassert_equal(cs->aura.hq_preset, AURA_PRESET_48_6_1);
	zassert_equal(cs->aura.hq_channels, AURA_CH_MONO_MIX);
	zassert_equal(cs->aura.hq_context, 0x0044);
	card_settings_unlock();
}

ZTEST(config_json, test_auracast_random_id_roundtrip)
{
	struct auracast_config aura;
	const struct card_settings *cs;

	aura_proto_config_defaults(&aura);
	zassert_equal(aura.broadcast_id, AURA_BROADCAST_ID_RANDOM);
	store_auracast(&aura);

	zassert_true(config_json_serialize(json, sizeof(json)) > 0);
	card_settings_lock();
	memset(card_settings_get(), 0, sizeof(struct card_settings));
	card_settings_unlock();
	zassert_equal(config_json_parse_and_apply(json), 0);

	card_settings_lock();
	cs = card_settings_get();
	zassert_equal(cs->aura.broadcast_id, AURA_BROADCAST_ID_RANDOM,
		      "0xFFFFFFFF must survive the JSON number round trip");
	zassert_true(cs->aura.enabled);
	card_settings_unlock();
}

ZTEST(config_json, test_auracast_missing_fields_default)
{
	/* A config written before the Auracast fields existed. */
	char partial[] = "{\n  \"card_type\": \"auracast\"\n}\n";
	struct auracast_config def;
	const struct card_settings *cs;

	aura_proto_config_defaults(&def);

	card_settings_lock();
	memset(card_settings_get(), 0x55, sizeof(struct card_settings));
	card_settings_unlock();

	zassert_equal(config_json_parse_and_apply(partial), 0);

	card_settings_lock();
	cs = card_settings_get();
	zassert_true(cs->valid);
	zassert_equal(cs->card_type, CARD_TYPE_AURACAST);
	zassert_true(cs->aura.enabled);
	zassert_equal(cs->aura.preset, def.preset);
	zassert_equal(cs->aura.channels, def.channels);
	zassert_equal(cs->aura.context, def.context);
	zassert_equal(cs->aura.flags, def.flags);
	zassert_equal(cs->aura.tx_power_dbm, def.tx_power_dbm);
	zassert_equal(cs->aura.pd_us, def.pd_us);
	zassert_equal(cs->aura.fifo_target, def.fifo_target);
	zassert_equal(cs->aura.broadcast_id, def.broadcast_id);
	zassert_str_equal(cs->aura.name, def.name);
	zassert_str_equal(cs->aura.code, "");
	zassert_equal(cs->aura.hq_preset, AURA_PRESET_NONE, "old config: no HQ subgroup");
	zassert_equal(cs->aura.hq_channels, def.hq_channels);
	zassert_equal(cs->aura.hq_context, def.hq_context);
	card_settings_unlock();
}
```
